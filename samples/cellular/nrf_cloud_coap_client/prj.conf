## prj.conf
```kconfig
#
# Copyright (c) 2023 Nordic Semiconductor ASA
#
# SPDX-License-Identifier: LicenseRef-Nordic-5-Clause
#
# General config
CONFIG_HEAP_MEM_POOL_SIZE=16384
CONFIG_NEWLIB_LIBC=y
CONFIG_NEWLIB_LIBC_FLOAT_PRINTF=y

CONFIG_DK_LIBRARY=y

# Mbed TLS logs include %zu formatters, which are not handled by the nano
# version of newlib
CONFIG_NEWLIB_LIBC_NANO=n

# Main thread
CONFIG_MAIN_STACK_SIZE=6144
CONFIG_SYSTEM_WORKQUEUE_STACK_SIZE=6144

# Networking
CONFIG_NETWORKING=y
CONFIG_NET_CONFIG_NEED_IPV6=n
CONFIG_NET_IPV4=y
CONFIG_NET_SOCKETS=y
CONFIG_NET_SOCKETS_POSIX_NAMES=y

# LTE link control
CONFIG_LTE_LINK_CONTROL=y
CONFIG_LTE_NETWORK_MODE_LTE_M_GPS=y

# Modem library
CONFIG_NRF_MODEM_LIB=y
CONFIG_NRF_MODEM_LIB_LOG_FW_VERSION_UUID=n

# Modem info
CONFIG_MODEM_INFO=y
CONFIG_MODEM_INFO_ADD_DEVICE=y
CONFIG_MODEM_INFO_ADD_NETWORK=y
CONFIG_MODEM_INFO_ADD_DATE_TIME=n
CONFIG_MODEM_INFO_ADD_SIM=n
CONFIG_MODEM_INFO_ADD_SIM_ICCID=n
CONFIG_MODEM_INFO_ADD_SIM_IMSI=n

# AT Host
CONFIG_UART_INTERRUPT_DRIVEN=y
CONFIG_UART_0_INTERRUPT_DRIVEN=y
CONFIG_AT_HOST_LIBRARY=y
CONFIG_AT_MONITOR_HEAP_SIZE=4096

# LTE link control
CONFIG_NET_L2_VIRTUAL=y

# Date/Time
CONFIG_DATE_TIME=y
CONFIG_DATE_TIME_AUTO_UPDATE=y
CONFIG_DATE_TIME_MODEM=y
CONFIG_DATE_TIME_NTP=n

CONFIG_FPU=y
CONFIG_CBPRINTF_FP_SUPPORT=y

CONFIG_NRF_CLOUD_COAP=y
CONFIG_COAP_CLIENT_BLOCK_SIZE=1024
CONFIG_COAP_CLIENT_STACK_SIZE=6144
CONFIG_COAP_CLIENT_THREAD_PRIORITY=0
CONFIG_COAP_EXTENDED_OPTIONS_LEN_VALUE=40

CONFIG_DOWNLOAD_CLIENT_STACK_SIZE=4096

# Flash - Used by FOTA and PGPS
CONFIG_FLASH=y
CONFIG_FLASH_PAGE_LAYOUT=y
CONFIG_FLASH_MAP=y
CONFIG_STREAM_FLASH=y
CONFIG_MPU_ALLOW_FLASH_WRITE=y
CONFIG_PM_EXTERNAL_FLASH_MCUBOOT_SECONDARY=n
CONFIG_FCB=y
CONFIG_SETTINGS=y
CONFIG_SETTINGS_FCB=y

# MCUBOOT - Needed by FOTA
CONFIG_BOOTLOADER_MCUBOOT=y
CONFIG_IMG_MANAGER=y
CONFIG_MCUBOOT_IMG_MANAGER=y
CONFIG_STREAM_FLASH_ERASE=y
CONFIG_IMG_ERASE_PROGRESSIVELY=y

CONFIG_REBOOT=y

# FOTA download
CONFIG_FOTA_DOWNLOAD=y
CONFIG_FOTA_DOWNLOAD_PROGRESS_EVT=y
CONFIG_DFU_TARGET=y
CONFIG_DOWNLOAD_CLIENT=y

CONFIG_LOG=y
CONFIG_NET_LOG=y
CONFIG_LOG_PRINTK=y
CONFIG_COAP_LOG_LEVEL_INF=y
CONFIG_NRF_CLOUD_COAP_LOG_LEVEL_INF=y
CONFIG_NRF_CLOUD_COAP_CLIENT_LOG_LEVEL_INF=y

# GNSS assistance
CONFIG_NRF_CLOUD_AGPS=y
CONFIG_NRF_CLOUD_PGPS=y
CONFIG_NRF_CLOUD_PGPS_REQUEST_UPON_INIT=y
CONFIG_NRF_CLOUD_PGPS_NUM_PREDICTIONS=4
```

## overlay-debug.conf
```kconfig
#
# Copyright (c) 2022 Nordic Semiconductor ASA
#
# SPDX-License-Identifier: LicenseRef-Nordic-5-Clause
#
# General config
CONFIG_DEBUG=y

# Logging
CONFIG_LOG=y
CONFIG_COAP_LOG_LEVEL_DBG=y
CONFIG_NRF_CLOUD_COAP_CLIENT_LOG_LEVEL_DBG=y
CONFIG_NRF_CLOUD_COAP_LOG_LEVEL_DBG=y
CONFIG_NRF_CLOUD_LOG_LEVEL_INF=y
CONFIG_NRF_CLOUD_GPS_LOG_LEVEL_INF=y
CONFIG_LTE_LINK_CONTROL_LOG_LEVEL_WRN=y
CONFIG_NET_LOG=y
CONFIG_NET_OFFLOAD_LOG_LEVEL_WRN=y
CONFIG_NET_UDP_LOG_LEVEL_WRN=y
CONFIG_NET_SOCKETS_LOG_LEVEL_WRN=y
CONFIG_NET_IF_LOG_LEVEL_WRN=y
CONFIG_NET_CONFIG_LOG_LEVEL_WRN=y
CONFIG_DNS_RESOLVER_LOG_LEVEL_WRN=n
CONFIG_NET_CONTEXT_LOG_LEVEL_WRN=y
CONFIG_AT_HOST_LOG_LEVEL_WRN=y
CONFIG_DATE_TIME_LOG_LEVEL_INF=y
CONFIG_SETTINGS_LOG_LEVEL_INF=y
CONFIG_DOWNLOAD_CLIENT_LOG_LEVEL_INF=y

CONFIG_LOG_PRINTK=y
CONFIG_LOG_MODE_IMMEDIATE=y
CONFIG_LOG_DEFAULT_LEVEL=3
CONFIG_LOG_FUNC_NAME_PREFIX_DBG=y
CONFIG_LOG_FUNC_NAME_PREFIX_INF=y
CONFIG_LOG_FUNC_NAME_PREFIX_WRN=y
CONFIG_LOG_FUNC_NAME_PREFIX_ERR=y

# Modem library
CONFIG_NRF_MODEM_LIB_LOG_LEVEL_INF=y
CONFIG_NRF_MODEM_LOG=n
```

## overlay-nrf7002ek-wifi-scan-only.conf
```kconfig
#
# Copyright (c) 2022 Nordic Semiconductor ASA
#
# SPDX-License-Identifier: LicenseRef-Nordic-5-Clause
#

# Overlay to use nRF7002 EK on top of nrf9160 DK for Wi-Fi scanning

# Actual configs for the Wi-Fi
CONFIG_WIFI=y
CONFIG_WIFI_NRF700X=y
# Also see comments for CONFIG_HEAP_MEM_POOL_SIZE.
CONFIG_NRF700X_SCAN_LIMIT=20
CONFIG_NET_L2_ETHERNET=y
CONFIG_NET_NATIVE=y

# System settings
CONFIG_NEWLIB_LIBC=y

# Scan only using offload API
CONFIG_WPA_SUPP=n
CONFIG_MBEDTLS=n
#CONFIG_NET_IPV4=n
CONFIG_NET_IPV6=n
#CONFIG_NET_UDP=n
#CONFIG_NET_TCP=n
CONFIG_NORDIC_SECURITY_BACKEND=n
CONFIG_NET_IF_MAX_IPV4_COUNT=2
CONFIG_NET_IF_MAX_IPV6_COUNT=2

# Stack/heap tweaks needed to support Wi-Fi.
# Heap allocation should be changed when CONFIG_LOCATION_METHOD_WIFI_SCANNING_RESULTS_MAX_CNT
# and CONFIG_NRF700X_SCAN_LIMIT (which should be the same value) are changed.
CONFIG_HEAP_MEM_POOL_SIZE=20000
CONFIG_NET_MGMT_EVENT_STACK_SIZE=2048

# NET tweaks needed to support Wi-Fi
CONFIG_NET_BUF_RX_COUNT=8
CONFIG_NET_BUF_TX_COUNT=8
CONFIG_NET_PKT_RX_COUNT=1
CONFIG_NET_PKT_TX_COUNT=1
CONFIG_NET_TX_STACK_SIZE=4096
CONFIG_NET_RX_STACK_SIZE=4096
CONFIG_NET_TC_TX_COUNT=1
CONFIG_NET_MAX_CONTEXTS=5

CONFIG_NRF_CLOUD_COAP_LOG_LEVEL_DBG=y
```

## src/main.c
```c
/*
 * Copyright (c) 2022 Nordic Semiconductor ASA
 *
 * SPDX-License-Identifier: LicenseRef-Nordic-5-Clause
 */

#include <stdio.h>
#include <string.h>

#include <zephyr/kernel.h>
#include <zephyr/net/coap.h>
#include <zephyr/net/socket.h>
#include <modem/lte_lc.h>
#include <modem/modem_info.h>
#include <modem/nrf_modem_lib.h>
#include <zephyr/random/rand32.h>
#include <dk_buttons_and_leds.h>
#include <nrf_socket.h>
#include <nrf_modem_at.h>
#include <date_time.h>
#include <net/nrf_cloud.h>
#include <net/nrf_cloud_coap.h>
#include <version.h>
#include "scan_wifi.h"
#include "handle_fota.h"

#include <zephyr/logging/log.h>
LOG_MODULE_REGISTER(nrf_cloud_coap_client, CONFIG_NRF_CLOUD_COAP_CLIENT_LOG_LEVEL);

#define SAMPLE_SIGNON_FMT "nRF Cloud CoAP Client Sample, version: %s"

#define CREDS_REQ_WAIT_SEC 10
#define APP_WAIT_CELLS_S 30
#define APP_WAIT_WIFI_S 30
#define BTN_NUM 1
#define APP_COAP_SEND_INTERVAL_MS 20000
#define APP_COAP_INTERVAL_LIMIT 60

/* Uncomment to incrementally increase time between coap packets */
/* #define DELAY_INTERPACKET_PERIOD */

/* Modem FW version required to properly run this sample */
#define MFWV_MAJ_SAMPLE_REQ	1
#define MFWV_MIN_SAMPLE_REQ	3
#define MFWV_REV_SAMPLE_REQ	0
/* Modem FW version required for extended neighbor cells search */
#define MFWV_MAJ_EXT_SRCH	1
#define MFWV_MIN_EXT_SRCH	3
#define MFWV_REV_EXT_SRCH	1
/* Modem FW version required for extended GCI neighbor cells search */
#define MFWV_MAJ_EXT_SRCH_GCI	1
#define MFWV_MIN_EXT_SRCH_GCI	3
#define MFWV_REV_EXT_SRCH_GCI	4

/* Type of data to be sent in the cellular positioning request */
enum nrf_cloud_location_type active_cell_pos_type = LOCATION_TYPE_SINGLE_CELL;

static bool connected;

/* Search type used for neighbor cell measurements; modem FW version depenedent */
static enum lte_lc_neighbor_search_type search_type = LTE_LC_NEIGHBOR_SEARCH_TYPE_EXTENDED_COMPLETE;

/* Buffer to hold neighbor cell measurement data for multi-cell requests */
static struct lte_lc_ncell neighbor_cells[CONFIG_LTE_NEIGHBOR_CELLS_MAX];

/* Buffer to hold GCI cell measurement data for multi-cell requests */
static struct lte_lc_cell gci_cells[5];

/* Modem info struct used for modem FW version and cell info used for single-cell requests */
#if defined(CONFIG_MODEM_INFO)
static struct modem_param_info mdm_param;
#endif

/* Structure to hold all cell info */
static struct lte_lc_cells_info cell_info;

/* Current RRC mode */
static enum lte_lc_rrc_mode cur_rrc_mode = LTE_LC_RRC_MODE_IDLE;

/* Flag to indicate that a neighbor cell measurement should be taken once RRC mode is idle */
static bool request_cells = true;

static bool pgps_active;

static volatile bool button_pressed;

/* Semaphore to indicate that cell info has been received */
static K_SEM_DEFINE(cell_info_ready_sem, 0, 1);

/* Mutex for cell info struct */
static K_MUTEX_DEFINE(cell_info_mutex);

#if defined(CONFIG_WIFI)
/* Semaphore to indicate Wi-Fi scanning is complete */
static K_SEM_DEFINE(wifi_scan_sem, 0, 1);
#endif

static void get_cell_info(void);
#if defined(CONFIG_NRF_CLOUD_PGPS)
static int do_pgps(struct gps_pgps_request *pgps_req);
#endif
static int update_shadow(void);
static void button_handler(uint32_t button_states, uint32_t has_changed);

static bool ver_check(int32_t reqd_maj, int32_t reqd_min, int32_t reqd_rev,
		      int32_t maj, int32_t min, int32_t rev)
{
	if (maj > reqd_maj) {
		return true;
	} else if ((maj == reqd_maj) && (min > reqd_min)) {
		return true;
	} else if ((maj == reqd_maj) && (min == reqd_min) && (rev >= reqd_rev)) {
		return true;
	}
	return false;
}

static void check_modem_fw_version(void)
{
	char mfwv_str[128];
	uint32_t major;
	uint32_t minor;
	uint32_t rev;

#if defined(CONFIG_MODEM_INFO)
	if (modem_info_string_get(MODEM_INFO_FW_VERSION, mfwv_str, sizeof(mfwv_str)) <= 0) {
		LOG_WRN("Failed to get modem FW version");
		return;
	}
#else
	strncpy(mfwv_str, "1.3.0", sizeof(mfwv_str));
#endif
	LOG_INF("Modem FW version: %s", mfwv_str);

	if (sscanf(mfwv_str, "mfw_nrf9160_%u.%u.%u", &major, &minor, &rev) != 3) {
		LOG_WRN("Unable to parse modem FW version number");
		return;
	}

	/* Ensure the modem firmware version meets the requirement for this sample */
	if (!ver_check(MFWV_MAJ_SAMPLE_REQ, MFWV_MIN_SAMPLE_REQ, MFWV_REV_SAMPLE_REQ,
		       major, minor, rev)) {
		LOG_ERR("This sample requires modem FW version %d.%d.%d or later",
			MFWV_MAJ_SAMPLE_REQ, MFWV_MIN_SAMPLE_REQ, MFWV_REV_SAMPLE_REQ);
		LOG_INF("Update modem firmware and restart");
		k_sleep(K_FOREVER);
	}

	/* Enable GCI/extended search if modem fw version allows */
	if (ver_check(MFWV_MAJ_EXT_SRCH_GCI, MFWV_MIN_EXT_SRCH_GCI, MFWV_REV_EXT_SRCH_GCI,
		      major, minor, rev)) {
		search_type = LTE_LC_NEIGHBOR_SEARCH_TYPE_EXTENDED_COMPLETE;
		LOG_INF("Using LTE LC neighbor search type GCI extended complete for %d cells",
			ARRAY_SIZE(gci_cells));
	} else if (ver_check(MFWV_MAJ_EXT_SRCH, MFWV_MIN_EXT_SRCH, MFWV_REV_EXT_SRCH,
			     major, minor, rev)) {
		search_type = LTE_LC_NEIGHBOR_SEARCH_TYPE_EXTENDED_COMPLETE;
		LOG_INF("Using LTE LC neighbor search type extended complete");
	} else {
		LOG_INF("Using LTE LC neighbor search type default");
	}
}

#if defined(CONFIG_NRF_MODEM_LIB)
/**@brief Recoverable modem library error. */
void nrf_modem_recoverable_error_handler(uint32_t err)
{
	LOG_ERR("Modem library recoverable error: %u", (unsigned int)err);
}
#endif /* defined(CONFIG_NRF_MODEM_LIB) */

K_SEM_DEFINE(lte_ready, 0, 1);

static void lte_handler(const struct lte_lc_evt *const evt)
{
	switch (evt->type) {
	case LTE_LC_EVT_NW_REG_STATUS:
		if ((evt->nw_reg_status == LTE_LC_NW_REG_REGISTERED_HOME) ||
		    (evt->nw_reg_status == LTE_LC_NW_REG_REGISTERED_ROAMING)) {
			LOG_DBG("Connected to LTE network");
			k_sem_give(&lte_ready);
		} else {
			LOG_DBG("reg status %d", evt->nw_reg_status);
		}
		break;

	case LTE_LC_EVT_CELL_UPDATE:
		if (evt->cell.id == LTE_LC_CELL_EUTRAN_ID_INVALID) {
			break;
		}

		/* Get new info when cell ID changes */
		LOG_DBG("Cell info changed");
		request_cells = true;
		get_cell_info();
		break;
	case LTE_LC_EVT_RRC_UPDATE:
		cur_rrc_mode = evt->rrc_mode;
		if (cur_rrc_mode == LTE_LC_RRC_MODE_IDLE) {
			LOG_DBG("RRC mode: idle");
		} else {
			LOG_DBG("RRC mode: connected");
		}
		if (request_cells && (cur_rrc_mode == LTE_LC_RRC_MODE_IDLE)) {
			get_cell_info();
		}
		break;
	case LTE_LC_EVT_NEIGHBOR_CELL_MEAS:
		if ((search_type < LTE_LC_NEIGHBOR_SEARCH_TYPE_GCI_DEFAULT) &&
		    (evt->cells_info.current_cell.id == LTE_LC_CELL_EUTRAN_ID_INVALID)) {
			LOG_WRN("Current cell ID not valid in neighbor cell measurement results");
			break;
		}

		(void)k_mutex_lock(&cell_info_mutex, K_FOREVER);
		/* Copy current cell information. */
		memcpy(&cell_info.current_cell,
		       &evt->cells_info.current_cell,
		       sizeof(cell_info.current_cell));

		/* Copy neighbor cell information if present. */
		cell_info.ncells_count = evt->cells_info.ncells_count;
		if ((cell_info.ncells_count > 0) && (evt->cells_info.neighbor_cells)) {
			memcpy(neighbor_cells,
			       evt->cells_info.neighbor_cells,
			       sizeof(neighbor_cells[0]) * cell_info.ncells_count);
			LOG_DBG("Received measurements for %u neighbor cells",
				cell_info.ncells_count);
		} else {
			LOG_DBG("No neighbor cells were measured");
		}

		/* Copy GCI cell information if present. */
		cell_info.gci_cells_count = evt->cells_info.gci_cells_count;
		if ((cell_info.gci_cells_count > 0) && (evt->cells_info.gci_cells)) {
			memcpy(gci_cells,
			       evt->cells_info.gci_cells,
			       sizeof(gci_cells[0]) * cell_info.gci_cells_count);
			LOG_DBG("Received measurements for %u GCI cells",
				cell_info.gci_cells_count);
		} else if (search_type == LTE_LC_NEIGHBOR_SEARCH_TYPE_GCI_EXTENDED_COMPLETE) {
			LOG_DBG("No GCI cells were measured");
		}

		(void)k_mutex_unlock(&cell_info_mutex);
		k_sem_give(&cell_info_ready_sem);

		break;
	default:
		LOG_DBG("LTE event %d (0x%x)", evt->type, evt->type);
		break;
	}
}

#if defined(CONFIG_NRF_CLOUD_PGPS)
void pgps_handler(struct nrf_cloud_pgps_event *event)
{
	switch (event->type) {
	case PGPS_EVT_INIT:
		LOG_INF("PGPS_EVT_INIT");
		break;
	case PGPS_EVT_UNAVAILABLE:
		LOG_INF("PGPS_EVT_UNAVAILABLE");
		break;
	case PGPS_EVT_LOADING:
		LOG_INF("PGPS_EVT_LOADING");
		break;
	case PGPS_EVT_AVAILABLE:
		LOG_INF("PGPS_EVT_AVAILABLE");
		break;
	case PGPS_EVT_READY:
		LOG_INF("PGPS_EVT_READY");
		pgps_active = false;
		break;
	case PGPS_EVT_REQUEST:
		LOG_INF("PGPS_EVT_REQUEST");
		pgps_active = true;
		do_pgps(event->request);
		break;
	}
}
#endif

/**@brief Configures modem to provide LTE link. Blocks until link is
 * successfully established.
 */
static int modem_configure(void)
{
	int err;

	err = nrf_modem_lib_init();
	if (err < 0) {
		LOG_ERR("Modem library initialization failed, error: %d", err);
		return err;
	} else if (err > 0) {
		LOG_INF("Modem firmware update in progress: 0x%X", err);
		return err;
	}

	lte_lc_register_handler(lte_handler);
	LOG_INF("LTE Link Connecting ...");
	err = lte_lc_init_and_connect();
	__ASSERT(err == 0, "LTE link could not be established.");
	k_sem_take(&lte_ready, K_FOREVER);
	LOG_INF("LTE Link Connected");
	err = lte_lc_psm_req(true);
	if (err) {
		LOG_ERR("Unable to enter PSM mode: %d", err);
	}

	err = nrf_modem_at_printf("AT+CEREG=5");
	if (err) {
		LOG_ERR("Can't subscribe to +CEREG events.");
	}

	/* Modem info library is used to obtain the modem FW version
	 * and network info for single-cell requests
	 */
#if defined(CONFIG_MODEM_INFO)
	err = modem_info_init();
	if (err) {
		LOG_ERR("Modem info initialization failed, error: %d", err);
		return err;
	}

	err = modem_info_params_init(&mdm_param);
	if (err) {
		LOG_ERR("Modem info params initialization failed, error: %d", err);
		return err;
	}

	err = modem_info_params_get(&mdm_param);
	if (err) {
		LOG_ERR("Modem info params reading failed, error: %d", err);
	}
#endif

	/* Check modem FW version */
	check_modem_fw_version();

	return err;
}

int init(void)
{
	int err;

	err = handle_fota_init();
	if (err) {
		LOG_ERR("Error initializing FOTA: %d", err);
		return err;
	}

	err = modem_configure();
	if (err) {
		return err;
	}

	err = handle_fota_begin();
	if (err) {
		return err;
	}

#if defined(CONFIG_WIFI)
	err = scan_wifi_init();
	if (err) {
		LOG_ERR("Error initializing Wi-Fi scanning: %d", err);
		return err;
	}
#endif

	err = nrf_cloud_coap_init();
	if (err) {
		LOG_ERR("Failed to initialize CoAP client: %d", err);
		return err;
	}

	err = nrf_cloud_coap_connect();
	if (err) {
		LOG_ERR("Failed to connect and get authorized: %d", err);
		return err;
	}
	connected = true;

	err = update_shadow();
	if (err) {
		LOG_ERR("Error updating shadow");
		return err;
	}
	LOG_INF("Shadow updated");

#if defined(CONFIG_NRF_CLOUD_PGPS)
	struct nrf_cloud_pgps_init_param param = {
		.event_handler = pgps_handler,
		.storage_base = 0,
		.storage_size = 0
	};

	err = nrf_cloud_pgps_init(&param);
	if (err) {
		LOG_ERR("Failed to initialize P-GPS: %d", err);
		return err;
	}
#endif

	/* Init the button */
	err = dk_buttons_init(button_handler);
	if (err) {
		LOG_ERR("Failed to initialize button: error: %d", err);
	}

	return err;
}

static void get_cell_info(void)
{
	int err;

	if (!connected || !request_cells) {
		return;
	}

	struct lte_lc_ncellmeas_params ncellmeas_params = {
		.search_type = search_type,
		.gci_count = ARRAY_SIZE(gci_cells)
	};

	/* Set the result buffers */
	cell_info.neighbor_cells = neighbor_cells;
	cell_info.gci_cells = gci_cells;

	LOG_INF("Requesting neighbor cell measurement");
	err = lte_lc_neighbor_cell_measurement(&ncellmeas_params);
	if (err) {
		LOG_ERR("Failed to start neighbor cell measurement, error: %d", err);
	} else {
		request_cells = false;
		LOG_INF("Waiting for measurement results...");
	}
}

#if defined(CONFIG_NRF_CLOUD_PGPS)
static int do_pgps(struct gps_pgps_request *pgps_req)
{
	int err;
	struct nrf_cloud_rest_pgps_request pgps_request;
	struct nrf_cloud_pgps_result pgps_res;
	static char host[64];
	static char path[128];

	LOG_INF("******** Getting P-GPS data");
	memset(&pgps_request, 0, sizeof(pgps_request));
	memset(&pgps_res, 0, sizeof(pgps_res));
	pgps_request.pgps_req = pgps_req;
	LOG_INF("period_min:%u, pred_cnt:%u, gps_day:%u, gps_time:%u",
		pgps_req->prediction_period_min, pgps_req->prediction_count,
		pgps_req->gps_day, pgps_req->gps_time_of_day);
	memset(host, 0, sizeof(host));
	memset(path, 0, sizeof(path));
	pgps_res.host = host;
	pgps_res.host_sz = sizeof(host);
	pgps_res.path = path;
	pgps_res.path_sz = sizeof(path);
	err = nrf_cloud_coap_pgps_url_get(&pgps_request, &pgps_res);
	if (err) {
		LOG_ERR("Failed to request P-GPS: %d", err);
		return err;
	}
	LOG_INF("P-GPS host:%s, host_sz:%u, path:%s, path_sz:%u",
		pgps_res.host, pgps_res.host_sz, pgps_res.path, pgps_res.path_sz);
	err = nrf_cloud_pgps_update(&pgps_res);
	if (err) {
		nrf_cloud_pgps_request_reset();
		LOG_ERR("P-GPS data processing failed, error: %d", err);
		return err;
	}

	LOG_DBG("P-GPS data processed");
	err = nrf_cloud_pgps_notify_prediction();
	if (err) {
		LOG_ERR("GNSS: Failed to request current prediction, error: %d", err);
	} else {
		LOG_DBG("P-GPS prediction requested");
	}
	return err;
}
#endif

#if defined(CONFIG_NRF_CLOUD_AGPS)
static uint8_t agps_buf[4096];

static int do_agps(void)
{
	int err;
	static bool got_agps;
	struct nrf_cloud_rest_agps_request agps_request;
	struct nrf_modem_gnss_agps_data_frame agps_req;
	struct nrf_cloud_rest_agps_result agps_res;

	if (got_agps) {
		LOG_INF("Not required yet.");
		return 0;
	}
	memset(&agps_request, 0, sizeof(agps_request));
	memset(&agps_req, 0, sizeof(agps_req));
	agps_request.type = NRF_CLOUD_REST_AGPS_REQ_CUSTOM;
	agps_request.net_info = &cell_info;
	agps_request.agps_req = &agps_req;
	agps_req.data_flags = 0x3f;
	agps_req.sv_mask_alm = 0xffffffff;
	agps_req.sv_mask_ephe = 0xffffffff;
	agps_res.buf = agps_buf;
	agps_res.buf_sz = sizeof(agps_buf);
	err = nrf_cloud_coap_agps_data_get(&agps_request, &agps_res);
	if (err) {
		LOG_ERR("Failed to request A-GPS: %d", err);
	} else {
		LOG_INF("Processing %u bytes of A-GPS data", agps_res.agps_sz);
		err = nrf_cloud_agps_process(agps_res.buf, agps_res.agps_sz);
		if (err) {
			LOG_ERR("A-GPS data processing failed, error: %d", err);
		}  else {
			LOG_INF("A-GPS data processed");
			got_agps = true;
		}
	}
	return err;
}
#endif

static int update_shadow(void)
{
	/* Enable FOTA for modem and application */
	struct nrf_cloud_svc_info_fota fota = {
		.modem = 1,
		.application = 1
	};
	struct nrf_cloud_svc_info_ui ui_info = {
		.gnss = true,
		.temperature = true
	};
	struct nrf_cloud_svc_info service_info = {
		.fota = &fota,
		.ui = &ui_info
	};
	struct nrf_cloud_modem_info modem_info = {
		.device = NRF_CLOUD_INFO_SET,
		.network = NRF_CLOUD_INFO_SET,
		.sim = IS_ENABLED(CONFIG_MODEM_INFO_ADD_SIM) ? NRF_CLOUD_INFO_SET : 0,
		/* Use the modem info already obtained */
#if defined(CONFIG_MODEM_INFO)
		.mpi = &mdm_param,
#endif
		/* Include the application version */
		.application_version = CONFIG_NRF_CLOUD_COAP_CLIENT_SAMPLE_VERSION
	};
	struct nrf_cloud_device_status device_status = {
		.modem = &modem_info,
		.svc = &service_info
	};

	return nrf_cloud_coap_shadow_device_status_update(&device_status);
}

static int do_next_test(void)
{
	static double temp = 21.5;
	static int cur_test = 1;
	static struct nrf_cloud_gnss_data gnss;
	static const char * const location_types[] = {
		"SINGLE CELL",
		"MULTI CELL",
		"WI-FI"
	};
	int err = 0;
	struct nrf_cloud_rest_location_request loc_request;
	struct nrf_cloud_location_result result;
	struct wifi_scan_info *wifi_info = NULL;
	char buf[512];
	const char *type;

	if (!gnss.type) {
		gnss.type = NRF_CLOUD_GNSS_TYPE_PVT;
		gnss.pvt.lat = 45.525616;
		gnss.pvt.lon = -122.685978;
		gnss.pvt.accuracy = 30;
	}

	printk("\n***********************************************\n");
	switch (cur_test) {
	case 1:
		printk("**** %d. Getting pending FOTA job execution ****\n", cur_test);
		err = handle_fota_process();
		if (err != -EAGAIN) {
			LOG_INF("FOTA check completed.");
		}
		break;
	case 2:
		printk("*** %d. Getting shadow delta *******************\n", cur_test);
		buf[0] = '\0';
		err = nrf_cloud_coap_shadow_get(buf, sizeof(buf), true);
		if (err) {
			LOG_ERR("Failed to request shadow delta: %d", err);
		} else {
			size_t len = strlen(buf);

			LOG_INF("Delta: %s", len ? buf : "None");
			if (len) {
				err = nrf_cloud_coap_shadow_state_update(buf);
				if (err) {
					LOG_ERR("Failed to acknowledge delta: %d", err);
				} else {
					LOG_INF("Delta acknowledged");
				}
			}
		}
		break;
	case 3:
		printk("*** %d. Sending temperature ********************\n", cur_test);
		err = nrf_cloud_coap_sensor_send(NRF_CLOUD_JSON_APPID_VAL_TEMP,
						 temp, NRF_CLOUD_NO_TIMESTAMP);
		if (err) {
			LOG_ERR("Error sending sensor data: %d", err);
			break;
		}
		LOG_INF("Sent %.1f C", temp);
		temp += 0.1;
		break;
	case 4:
		printk("*** %d. Getting position ***********************\n", cur_test);
#if defined(CONFIG_WIFI)
		err = scan_wifi_start(&wifi_scan_sem);
		LOG_INF("Waiting for Wi-Fi scans...");
		if (err) {
			LOG_ERR("Error starting Wi-Fi scan: %d", err);
			err = 0;
			break;
		}
		k_sem_take(&wifi_scan_sem, K_SECONDS(APP_WAIT_WIFI_S));
		wifi_info = scan_wifi_results_get();
#endif
		LOG_INF("Waiting for neighbor cells..");
		err = k_sem_take(&cell_info_ready_sem, K_SECONDS(APP_WAIT_CELLS_S));
		if (err) {
			LOG_ERR("Timeout waiting for cells: %d", err);
			err = 0;
			if (!IS_ENABLED(CONFIG_WIFI)) {
				break;
			}
		}

		(void)k_mutex_lock(&cell_info_mutex, K_FOREVER);

		if (cell_info.current_cell.id != LTE_LC_CELL_EUTRAN_ID_INVALID) {
			LOG_INF("Current cell info: Cell ID: %u, TAC: %u, MCC: %d, MNC: %d",
				cell_info.current_cell.id, cell_info.current_cell.tac,
				cell_info.current_cell.mcc, cell_info.current_cell.mnc);
		} else {
			LOG_WRN("No current serving cell available");
		}

		if (cell_info.ncells_count || cell_info.gci_cells_count) {
			LOG_INF("Performing multi-cell request with "
				"%u neighbor cells and %u GCI cells",
				cell_info.ncells_count, cell_info.gci_cells_count);
		} else {
			LOG_INF("Performing single-cell request");
		}

		loc_request.cell_info = &cell_info;
		loc_request.wifi_info = wifi_info;
		err = nrf_cloud_coap_location_get(&loc_request, &result);
		(void)k_mutex_unlock(&cell_info_mutex);
		if (err) {
			LOG_ERR("Unable to get location: %d", err);
			break;
		}

		if ((result.type >= 0) && (result.type < LOCATION_TYPE__INVALID)) {
			type = location_types[result.type];
		} else {
			type = "unknown";
		}
		/* Process the returned location once it arrives */
		gnss.pvt.lat = result.lat;
		gnss.pvt.lon = result.lon;
		gnss.pvt.accuracy = result.unc;
		LOG_INF("Location: %s, %.12g, %.12g, %d", type,
			result.lat, result.lon, result.unc);

		request_cells = true;
		break;
	case 5:
		printk("*** %d. Sending GNSS PVT ***********************\n", cur_test);
		err = nrf_cloud_coap_location_send(&gnss);
		if (err) {
			LOG_ERR("Error sending GNSS PVT data: %d", err);
		} else {
			LOG_INF("PVT sent");
		}
		break;
	case 6:
#if defined(CONFIG_NRF_CLOUD_AGPS)
		printk("*** %d. Getting A-GPS data *********************\n", cur_test);
		err = do_agps();
		break;
#else
		printk("*** %d. Skipping A-GPS *************************\n", cur_test);
#endif
	}

	if (++cur_test > 6) {
		cur_test = 1;
	}
	return err;
}

static void button_handler(uint32_t button_states, uint32_t has_changed)
{
	if (has_changed & button_states & BIT(BTN_NUM - 1)) {
		LOG_INF("Button %d pressed", BTN_NUM);
		button_pressed = true;
	}
}

int main(void)
{
	int64_t next_msg_time;
	int delta_ms = APP_COAP_SEND_INTERVAL_MS;
	int err;
	int i = 1;

	LOG_INF(SAMPLE_SIGNON_FMT,
		CONFIG_NRF_CLOUD_COAP_CLIENT_SAMPLE_VERSION);

	err = init();
	if (err) {
		LOG_ERR("Initialization failed. Stopping.");
		return 0;
	}

	next_msg_time = k_uptime_get() + delta_ms;

	while (1) {
		if (!pgps_active && (k_uptime_get() >= next_msg_time)) {

			if (!connected) {
				LOG_INF("Going online");
				err = lte_lc_normal();
				if (err) {
					LOG_ERR("Error going online: %d", err);
				} else {
					k_sem_take(&lte_ready, K_FOREVER);
					err = nrf_cloud_coap_connect();
					if (err) {
						LOG_ERR("Failed to connect and get authorized: %d",
							err);
						next_msg_time += delta_ms;
						continue;
					}
					connected = true;
				}
			}

			if (connected) {
				err = do_next_test();

				if ((err == -EAGAIN) || button_pressed) {
					connected = false;
					if (button_pressed) {
						LOG_INF("Disconnecting due to button press...");
						button_pressed = false;
					}
					LOG_INF("Disconnecting CoAP");
					err = nrf_cloud_coap_disconnect();
					if (err) {
						LOG_ERR("Error closing socket: %d", err);
					} else {
						LOG_INF("Socket closed.");
					}
					LOG_INF("LTE going offline");
					err = lte_lc_offline();
					if (err) {
						LOG_ERR("Error going offline: %d", err);
					} else {
						LOG_INF("Offline.");
					}
					k_sleep(K_SECONDS(5));
				}
			}

			delta_ms = APP_COAP_SEND_INTERVAL_MS * i;
			next_msg_time += delta_ms;
#if defined(DELAY_INTERPACKET_PERIOD)
			LOG_INF("Next transfer in %d minutes, %d seconds",
				delta_ms / 60000, (delta_ms / 1000) % 60);
			if (++i > APP_COAP_INTERVAL_LIMIT) {
				i = APP_COAP_INTERVAL_LIMIT;
			}
#endif
		}
		k_sleep(K_MSEC(100));
	}
	return err;
}
```

## src/handle_fota.c
```c
/*
 * Copyright (c) 2021 Nordic Semiconductor ASA
 *
 * SPDX-License-Identifier: LicenseRef-Nordic-5-Clause
 */

#include <zephyr/kernel.h>
#include <modem/nrf_modem_lib.h>
#include <nrf_modem_at.h>
#include <zephyr/settings/settings.h>
#include <net/nrf_cloud.h>
#include <zephyr/sys/reboot.h>
#include <zephyr/logging/log.h>
#include <zephyr/logging/log_ctrl.h>
#include <net/fota_download.h>
#include <net/nrf_cloud_coap.h>
#include "handle_fota.h"

LOG_MODULE_REGISTER(nrf_cloud_coap_fota, CONFIG_NRF_CLOUD_COAP_CLIENT_LOG_LEVEL);

#define PENDING_REBOOT_S	10
#define JOB_WAIT_S		30
#define ERROR_REBOOT_S		30
#define FOTA_REBOOT_S		10

/* Use the settings library to store FOTA job information to flash so
 * that the job status can be updated after a reboot
 */
#if defined(CONFIG_COAP_FOTA_USE_NRF_CLOUD_SETTINGS_AREA)
#define FOTA_SETTINGS_NAME		NRF_CLOUD_SETTINGS_FULL_FOTA
#define FOTA_SETTINGS_KEY_PENDING_JOB	NRF_CLOUD_SETTINGS_FOTA_JOB
#define FOTA_SETTINGS_FULL		NRF_CLOUD_SETTINGS_FULL_FOTA_JOB
#else
#define FOTA_SETTINGS_NAME		CONFIG_COAP_FOTA_SETTINGS_NAME
#define FOTA_SETTINGS_KEY_PENDING_JOB	CONFIG_COAP_FOTA_SETTINGS_KEY_PENDING_JOB
#define FOTA_SETTINGS_FULL		FOTA_SETTINGS_NAME "/" FOTA_SETTINGS_KEY_PENDING_JOB
#endif

#define FOTA_DL_FRAGMENT_SZ	1400

/* FOTA job status strings that provide additional details for nrf_cloud_fota_status values */
const char * const FOTA_STATUS_DETAILS_TIMEOUT = "Download did not complete in the allotted time";
const char * const FOTA_STATUS_DETAILS_DL_ERR  = "Error occurred while downloading the file";
const char * const FOTA_STATUS_DETAILS_MDM_REJ = "Modem rejected the update; invalid delta?";
const char * const FOTA_STATUS_DETAILS_MDM_ERR = "Modem was unable to apply the update";
const char * const FOTA_STATUS_DETAILS_MCU_REJ = "Device rejected the update";
const char * const FOTA_STATUS_DETAILS_MCU_ERR = "Update could not be validated";
const char * const FOTA_STATUS_DETAILS_SUCCESS = "FOTA update completed successfully";
const char * const FOTA_STATUS_DETAILS_NO_VALIDATE = "FOTA update completed without validation";
const char * const FOTA_STATUS_DETAILS_MISMATCH = "FW file does not match specified FOTA type";

/* Semaphore to indicate the FOTA download has arrived at a terminal state */
static K_SEM_DEFINE(fota_download_sem, 0, 1);

/* FOTA job info received from nRF Cloud */
static struct nrf_cloud_fota_job_info job;

/* FOTA job status */
static enum nrf_cloud_fota_status fota_status = NRF_CLOUD_FOTA_QUEUED;
static char const *fota_status_details = FOTA_STATUS_DETAILS_SUCCESS;

/* Pending job info used with the settings library */
static struct nrf_cloud_settings_fota_job pending_job = {
	.type = NRF_CLOUD_FOTA_TYPE__INVALID,
	.validate = NRF_CLOUD_FOTA_VALIDATE_NONE
};

#if defined(CONFIG_NRF_CLOUD_FOTA_FULL_MODEM_UPDATE)
/* Flag to indicate if full modem FOTA is enabled */
static bool full_modem_fota_initd;
#endif

static int coap_fota_settings_set(const char *key, size_t len_rd,
			    settings_read_cb read_cb, void *cb_arg);

SETTINGS_STATIC_HANDLER_DEFINE(coap_fota, FOTA_SETTINGS_NAME, NULL,
			       coap_fota_settings_set, NULL, NULL);

static int coap_fota_settings_set(const char *key, size_t len_rd, settings_read_cb read_cb,
				  void *cb_arg)
{
	ssize_t sz;

	if (!key) {
		LOG_DBG("Key is NULL");
		return -EINVAL;
	}

	LOG_DBG("Settings key: %s, size: %d", key, len_rd);

	if (strncmp(key, FOTA_SETTINGS_KEY_PENDING_JOB, strlen(FOTA_SETTINGS_KEY_PENDING_JOB))) {
		return -ENOMSG;
	}

	if (len_rd > sizeof(pending_job)) {
		LOG_INF("FOTA settings size larger than expected");
		len_rd = sizeof(pending_job);
	}

	sz = read_cb(cb_arg, (void *)&pending_job, len_rd);
	if (sz == 0) {
		LOG_DBG("FOTA settings key-value pair has been deleted");
		return -EIDRM;
	} else if (sz < 0) {
		LOG_ERR("FOTA settings read error: %d", sz);
		return -EIO;
	}

	if (sz == sizeof(pending_job)) {
		LOG_INF("Saved job: %s, type: %d, validate: %d, bl: 0x%X",
			pending_job.id, pending_job.type,
			pending_job.validate, pending_job.bl_flags);
	} else {
		LOG_INF("FOTA settings size smaller than current, likely outdated");
	}

	return 0;
}

static int save_pending_job(void)
{
	int ret = settings_save_one(FOTA_SETTINGS_FULL, &pending_job, sizeof(pending_job));

	if (ret) {
		LOG_ERR("Failed to save FOTA job to settings, error: %d", ret);
	}

	return ret;
}

static void http_fota_dl_handler(const struct fota_download_evt *evt)
{
	LOG_DBG("evt: %d", evt->id);

	switch (evt->id) {
	case FOTA_DOWNLOAD_EVT_FINISHED:
		LOG_INF("FOTA download finished");
		fota_status = NRF_CLOUD_FOTA_SUCCEEDED;
		k_sem_give(&fota_download_sem);
		break;
	case FOTA_DOWNLOAD_EVT_ERASE_PENDING:
		LOG_INF("FOTA download erase pending");
		fota_status = NRF_CLOUD_FOTA_SUCCEEDED;
		k_sem_give(&fota_download_sem);
		break;
	case FOTA_DOWNLOAD_EVT_ERASE_DONE:
		LOG_DBG("FOTA download erase done");
		break;
	case FOTA_DOWNLOAD_EVT_ERROR:
		LOG_INF("FOTA download error: %d", evt->cause);

		fota_status = NRF_CLOUD_FOTA_FAILED;
		fota_status_details = FOTA_STATUS_DETAILS_DL_ERR;

		if (evt->cause == FOTA_DOWNLOAD_ERROR_CAUSE_INVALID_UPDATE) {
			fota_status = NRF_CLOUD_FOTA_REJECTED;
			if (nrf_cloud_fota_is_type_modem(job.type)) {
				fota_status_details = FOTA_STATUS_DETAILS_MDM_REJ;
			} else {
				fota_status_details = FOTA_STATUS_DETAILS_MCU_REJ;
			}
		} else if (evt->cause == FOTA_DOWNLOAD_ERROR_CAUSE_TYPE_MISMATCH) {
			fota_status_details = FOTA_STATUS_DETAILS_MISMATCH;
		}
		k_sem_give(&fota_download_sem);
		break;
	case FOTA_DOWNLOAD_EVT_PROGRESS:
		LOG_INF("FOTA download percent: %d", evt->progress);
		break;
	default:
		break;
	}
}

static bool pending_fota_job_exists(void)
{
	return (pending_job.validate != NRF_CLOUD_FOTA_VALIDATE_NONE);
}

static void process_pending_job(void)
{
	bool reboot_required = false;
	int ret;

	LOG_INF("Checking for pending FOTA job");
	ret = nrf_cloud_pending_fota_job_process(&pending_job, &reboot_required);

	if ((ret == 0) && reboot_required) {
		/* Save validate status and reboot */
		(void)save_pending_job();

		/* Sleep to display log message */
		LOG_INF("Rebooting in %us...", PENDING_REBOOT_S);
		k_sleep(K_SECONDS(PENDING_REBOOT_S));
		sys_reboot(SYS_REBOOT_COLD);
	}
}

int handle_fota_init(void)
{
	int err;

	LOG_INF("Loading FOTA settings...");
	err = settings_subsys_init();
	if (err) {
		LOG_ERR("Failed to initialize settings subsystem, error: %d", err);
		return err;
	}
	err = settings_load_subtree(settings_handler_coap_fota.name);
	if (err) {
		LOG_WRN("Failed to load settings, error: %d", err);
	}

#if defined(CONFIG_NRF_CLOUD_FOTA_FULL_MODEM_UPDATE)
	struct dfu_target_fmfu_fdev fmfu_dev_inf = {
		.size = 0,
		.offset = 0,
		/* CONFIG_DFU_TARGET_FULL_MODEM_USE_EXT_PARTITION is enabled, so no need
		 * to specify the flash device here
		 */
		.dev = NULL
	};

	err = nrf_cloud_fota_fmfu_dev_set(&fmfu_dev_inf);
	if (err < 0) {
		LOG_WRN("Full modem FOTA not initialized");
		return err;
	}

	full_modem_fota_initd = true;
#endif
	return err;
}

int handle_fota_begin(void)
{
	int err;

	/* This function may perform a reboot if a FOTA update is in progress */
	process_pending_job();

	err = fota_download_init(http_fota_dl_handler);
	if (err) {
		LOG_ERR("Failed to initialize FOTA download, error: %d", err);
		return err;
	}

	return 0;
}

static bool validate_in_progress_job(void)
{
	/* Update in progress job status if validation has been done */
	if (pending_fota_job_exists()) {

		if (pending_job.validate == NRF_CLOUD_FOTA_VALIDATE_PASS) {
			fota_status = NRF_CLOUD_FOTA_SUCCEEDED;
			fota_status_details = FOTA_STATUS_DETAILS_SUCCESS;
		} else if (pending_job.validate == NRF_CLOUD_FOTA_VALIDATE_FAIL) {
			fota_status = NRF_CLOUD_FOTA_FAILED;
			if (nrf_cloud_fota_is_type_modem(pending_job.type)) {
				fota_status_details = FOTA_STATUS_DETAILS_MDM_ERR;
			} else {
				fota_status_details = FOTA_STATUS_DETAILS_MCU_ERR;
			}
		} else {
			fota_status = NRF_CLOUD_FOTA_SUCCEEDED;
			fota_status_details = FOTA_STATUS_DETAILS_NO_VALIDATE;
		}
		LOG_DBG("FOTA job completed");
		return true;
	}

	LOG_DBG("No FOTA job to update");
	return false;
}

static int check_for_job(void)
{
	int err;

	LOG_INF("Checking for FOTA job...");
	err = nrf_cloud_coap_fota_job_get(&job);
	if (err == -ENOMSG) {
		LOG_INF("No pending FOTA job");
		return 1;
	} else if (err < 0) {
		LOG_ERR("Failed to fetch FOTA job, error: %d", err);
		return -ENOENT;
	} else if (err > 0) {
		return err;
	}

	if (job.type == NRF_CLOUD_FOTA_TYPE__INVALID) {
		LOG_INF("No pending FOTA job");
		return 1;
	}

	LOG_INF("FOTA Job: %s, type: %d\n", job.id ? job.id : "<none>", job.type);
	return 0;
}

static int update_job_status(void)
{
	int err;
	bool is_job_pending = pending_fota_job_exists();

	/* Send FOTA job status to nRF Cloud and, if successful, clear pending job in settings */
	LOG_INF("Updating FOTA job status...");
	err = nrf_cloud_coap_fota_job_update(is_job_pending ? pending_job.id : job.id,
					     fota_status, fota_status_details);

	pending_job.validate	= NRF_CLOUD_FOTA_VALIDATE_NONE;
	pending_job.type	= NRF_CLOUD_FOTA_TYPE__INVALID;
	pending_job.bl_flags	= NRF_CLOUD_FOTA_BL_STATUS_CLEAR;
	memset(pending_job.id, 0, NRF_CLOUD_FOTA_JOB_ID_SIZE);

	if (err) {
		LOG_ERR("Failed to update FOTA job, error: %d", err);
	} else {
		LOG_INF("FOTA job updated, status: %d", fota_status);

		/* Clear the pending job in settings */
		if (is_job_pending) {
			(void)save_pending_job();
		}
	}

	return err;
}

static int start_download(void)
{
	enum dfu_target_image_type img_type;

	/* Start the FOTA download, specifying the job/image type */
	switch (job.type) {
	case NRF_CLOUD_FOTA_BOOTLOADER:
	case NRF_CLOUD_FOTA_APPLICATION:
		img_type = DFU_TARGET_IMAGE_TYPE_MCUBOOT;
		break;
	case NRF_CLOUD_FOTA_MODEM_DELTA:
		img_type = DFU_TARGET_IMAGE_TYPE_MODEM_DELTA;
		break;
	case NRF_CLOUD_FOTA_MODEM_FULL:
		img_type = DFU_TARGET_IMAGE_TYPE_FULL_MODEM;
		break;
	default:
		LOG_ERR("Unhandled FOTA type: %d", job.type);
		return -EFTYPE;
	}

	LOG_INF("Starting FOTA download of %s/%s", job.host, job.path);
	int err = fota_download_start_with_image_type(job.host, job.path,
		CONFIG_NRF_CLOUD_SEC_TAG, 0, FOTA_DL_FRAGMENT_SZ,
		img_type);

	if (err != 0) {
		LOG_ERR("Failed to start FOTA download, error: %d", err);
		return -ENODEV;
	}

	return 0;
}

static int wait_for_download(void)
{
	LOG_INF("Waiting for FOTA download to complete");
	int err = k_sem_take(&fota_download_sem,
			K_MINUTES(CONFIG_COAP_FOTA_DL_TIMEOUT_MIN));
	if (err == -EAGAIN) {
		fota_download_cancel();
		return -ETIMEDOUT;
	} else if (err != 0) {
		LOG_ERR("k_sem_take error: %d", err);
		return -ENOLCK;
	}

	return 0;
}

static void handle_download_succeeded_and_reboot(void)
{
	int err;

	/* Save the pending FOTA job info to flash */
	memcpy(pending_job.id, job.id, NRF_CLOUD_FOTA_JOB_ID_SIZE);
	pending_job.type = job.type;
	pending_job.validate = NRF_CLOUD_FOTA_VALIDATE_PENDING;
	pending_job.bl_flags = NRF_CLOUD_FOTA_BL_STATUS_CLEAR;

	err = nrf_cloud_bootloader_fota_slot_set(&pending_job);
	if (err) {
		LOG_WRN("Failed to set B1 slot flag, BOOT FOTA validation may be incorrect");
	}

	(void)lte_lc_deinit();

#if defined(CONFIG_NRF_CLOUD_FOTA_FULL_MODEM_UPDATE)
	if (job.type == NRF_CLOUD_FOTA_MODEM_FULL) {
		LOG_INF("Applying full modem FOTA update...");
		err = nrf_cloud_fota_fmfu_apply();
		if (err) {
			LOG_ERR("Failed to apply full modem FOTA update %d", err);
			pending_job.validate = NRF_CLOUD_FOTA_VALIDATE_FAIL;
		} else {
			pending_job.validate = NRF_CLOUD_FOTA_VALIDATE_PASS;
		}
	}
#endif

	err = save_pending_job();
	if (err) {
		LOG_WRN("FOTA job will be marked as successful without validation");
		fota_status_details = FOTA_STATUS_DETAILS_NO_VALIDATE;
		(void)update_job_status();
	}

	LOG_INF("Rebooting in %us to complete FOTA update...", FOTA_REBOOT_S);
	k_sleep(K_SECONDS(FOTA_REBOOT_S));
	sys_reboot(SYS_REBOOT_COLD);
}

static void cleanup(void)
{
	nrf_cloud_coap_fota_job_free(&job);
}

static void wait_after_job_update(void)
{
	/* Job operations can take up to 30s to be processed */
	LOG_INF("Waiting %u seconds for job update to be processed by nRF Cloud...", JOB_WAIT_S);
	cleanup();
	k_sleep(K_SECONDS(JOB_WAIT_S));
}

static void error_reboot(void)
{
	LOG_INF("Rebooting due to error in %us...", ERROR_REBOOT_S);
	(void)lte_lc_deinit();
	k_sleep(K_SECONDS(ERROR_REBOOT_S));
	sys_reboot(SYS_REBOOT_COLD);
}

int handle_fota_process(void)
{
	int err;

	/* If a FOTA job is in progress, handle it first */
	if (validate_in_progress_job()) {
		err = update_job_status();
		if (err) {
			LOG_ERR("Error; must reboot: %d", err);
			error_reboot();
		}
		wait_after_job_update();
		return -ENOENT;
	}

	/* Check for a new FOTA job */
	err = check_for_job();
	if (err < 0) {
		return err;
	}

	if (err > 0) {
		/* No job. Wait for the configured duration or a button press */
		cleanup();

#if defined(COAP_FOTA_USE_THREAD)
		LOG_DBG("Retrying in %d minute(s)", CONFIG_COAP_FOTA_JOB_CHECK_RATE_MIN);
#endif
		return -ENOENT;
	}

	/* Start the FOTA download process and wait for completion (or timeout) */
	err = start_download();
	if (err) {
		return err;
	}
	err = wait_for_download();
	if (err == -ETIMEDOUT) {
		LOG_ERR("Timeout; FOTA download took longer than %d minutes",
			CONFIG_COAP_FOTA_DL_TIMEOUT_MIN);
		fota_status = NRF_CLOUD_FOTA_TIMED_OUT;
		fota_status_details = FOTA_STATUS_DETAILS_TIMEOUT;
	}

	/* On download success, save job info and reboot to complete installation.
	 * Job status will be sent to nRF Cloud after reboot and validation.
	 */
	if (fota_status == NRF_CLOUD_FOTA_SUCCEEDED) {
		LOG_INF("FOTA download succeeded");
		handle_download_succeeded_and_reboot();
	}

	/* Job was not successful, send status to nRF Cloud */
	err = update_job_status();
	if (err) {
		LOG_ERR("Error updating job status: %d", err);
	}

	wait_after_job_update();

	return err;
}

#if defined(COAP_FOTA_USE_THREAD)

#define FOTA_THREAD_DELAY_S 5

static int fota_thread(void)
{
	int err;

	while (1) {
		err = coap_fota_handle();
		if (err == -EAGAIN) {
			k_sleep(K_MINUTES(CONFIG_COAP_FOTA_JOB_CHECK_RATE_MIN));
		} else {
			k_sleep(K_SECONDS(FOTA_THREAD_DELAY_S));
		}
	}
	return 0;
}

K_THREAD_DEFINE(coap_fota, CONFIG_COAP_FOTA_THREAD_STACK_SIZE, fota_thread,
		NULL, NULL, NULL, 0, 0, 0);

#endif /* COAP_FOTA_USE_THREAD */
```
