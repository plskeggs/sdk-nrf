## Kconfig
```
#
# Copyright (c) 2022 Nordic Semiconductor ASA
#
# SPDX-License-Identifier: LicenseRef-Nordic-5-Clause
#

menu "Multi Service Sample Settings"

config APP_VERSION
	string "Multi Service Sample version"
	default "1.0.0"

config CLOUD_CONNECTION_RETRY_TIMEOUT_SECONDS
	int "Cloud connection retry timeout (seconds)"
	default 30
	help
	  If connecting to nRF Cloud takes longer than this timeout, it will be
	  reattempted.

config CLOUD_READY_TIMEOUT_SECONDS
	int "Cloud readiness timeout (seconds)"
	default 600
	help
	  If the connection to nRF Cloud does not become ready within this
	  timeout, the sample will reset its connection and try again.

config CLOUD_ASSOCIATION_TIMEOUT_SECONDS
	int "Cloud association timeout (seconds)"
	default 30
	help
	  If association with nRF Cloud does not occur within this
	  timeout, ping the connection to ensure delta is received.

config DATE_TIME_ESTABLISHMENT_TIMEOUT_SECONDS
	int "Modem date and time establishment timeout (seconds)"
	default 300
	help
	  The sample will wait this many seconds for the modem to determine the
	  current date and time before giving up and moving on.

config APPLICATION_THREAD_STACK_SIZE
	int "Application Thread Stack Size (bytes)"
	default 2048
	help
	  Sets the stack size (in bytes) for the application thread of the
	  sample.

config CONNECTION_THREAD_STACK_SIZE
	int "Connection Thread Stack Size (bytes)"
	default 2048
	help
	  Sets the stack size (in bytes) for the connection thread of the
	  sample.

config MESSAGE_THREAD_STACK_SIZE
	int "Message Queue Thread Stack Size (bytes)"
	default 2048
	help
	  Sets the stack size (in bytes) for the message queue processing
	  thread of the sample.

config LED_THREAD_STACK_SIZE
	int "LED Thread Stack Size (bytes)"
	default 1024
	help
	  Sets the stack size (in bytes) for the LED thread.

config MAX_OUTGOING_MESSAGES
	int "Outgoing message maximum"
	default 25
	help
	  Sets the maximum number of device messages which may be enqueued
	  before further messages are dropped.
	  Increasing this value may require an increase to CONFIG_HEAP_MEM_POOL_SIZE.

config MAX_CONSECUTIVE_SEND_FAILURES
	int "Max outgoing consecutive send failures"
	default 5
	help
	  Sets the maximum number of device messages which may fail to send
	  before a connection reset and cooldown is triggered.

config CONSECUTIVE_SEND_FAILURE_COOLDOWN_SECONDS
	int "Cooldown after max consecutive send failures exceeded"
	default 10
	help
	  If a connection reset is triggered by too many failed device
	  messages, the sample will wait this long (in seconds) before trying
	  again.

config SENSOR_SAMPLE_INTERVAL_SECONDS
	int "Sensor sampling interval (seconds)"
	default 60
	help
	  Sets the time to wait between each sensor sample.

menuconfig LOCATION_TRACKING
	bool "Location tracking service"
	default y
	help
	  Uses GNSS, LTE, and/or Wi-Fi information to determine and report device
	  location.

if LOCATION_TRACKING

config LOCATION_TRACKING_SAMPLE_INTERVAL_SECONDS
	int "Location sampling interval (seconds)"
	default 60
	help
	  Sets the location sampling interval in seconds.

config LOCATION_TRACKING_GNSS
	bool "Use GNSS method for location tracking"
	default y
	depends on LOCATION_METHOD_GNSS
	help
	  Disable all location tracking methods to completely disable location tracking.

config LOCATION_TRACKING_CELLULAR
	bool "Use cellular method for location tracking"
	default y
	depends on LOCATION_METHOD_CELLULAR
	help
	  Disable all location tracking methods to completely disable location tracking.

config LOCATION_TRACKING_WIFI
	bool "Use Wi-Fi method for location tracking"
	default n
	depends on LOCATION_METHOD_WIFI
	help
	  Requires the use of an nRF7002 companion chip.
	  Disable all location tracking methods to completely disable location tracking.

endif

config TEMP_DATA_USE_SENSOR
	bool "Use genuine temperature data"
	depends on BOARD_THINGY91_NRF9160_NS || BOARD_THINGY91X_NRF9151_NS
	default y if BOARD_THINGY91_NRF9160_NS || BOARD_THINGY91X_NRF9151_NS
	select SENSOR
	select BME680
	help
	  Sets whether to take genuine temperature measurements from a
	  connected BME680 sensor, or just simulate sensor data.

config TEMP_TRACKING
	bool "Track temperature"
	default y
	select NRF_CLOUD_ENABLE_SVC_INF_UI_TEMP
	help
	  Sets whether to take temperature measurements.

config TEMP_ALERT_LIMIT
	int "Temperature limit to send alert"
	default 30
	help
	  Sets the temperature in degrees C over which a temperature alert will
	  be sent to the cloud.

choice
	prompt "LED indication"
	default LED_INDICATION_PWM if BOARD_THINGY91_NRF9160_NS || BOARD_THINGY91X_NRF9151_NS
	default LED_INDICATION_GPIO if BOARD_NRF9160DK_NRF9160_NS || BOARD_NRF9161DK_NRF9161_NS || $(dt_compat_enabled,gpio-leds)
	default LED_INDICATION_DISABLED

	config LED_INDICATION_PWM
		select LED
		select LED_PWM
		select PWM
		bool "Enable LED indication using the pwm-leds driver"

	config LED_INDICATION_GPIO
		select LED
		select LED_GPIO
		bool "Enable LED indication using the gpio-leds driver"

	config LED_INDICATION_DISABLED
		bool "Disable LED indication"
endchoice

choice
	prompt "LED indication LED type"
	depends on !LED_INDICATION_DISABLED
	default LED_INDICATOR_RGB if (BOARD_THINGY91_NRF9160_NS || BOARD_THINGY91X_NRF9151_NS) && LED_INDICATION_PWM
	default LED_INDICATOR_4LED if !LED_INDICATION_DISABLED
	default LED_INDICATOR_NONE

	config LED_INDICATOR_RGB
		depends on LED_INDICATION_PWM
		bool "A single RGB LED"

	config LED_INDICATOR_4LED
		depends on !LED_INDICATION_DISABLED
		bool "Four binary LEDs"

	config LED_INDICATOR_NONE
		depends on LED_INDICATION_DISABLED
		bool "No indicator LEDs"

endchoice

config LED_VERBOSE_INDICATION
	depends on !LED_INDICATION_DISABLED
	bool "Enables extra LED status indications"
	default y

config LED_CONTINUOUS_INDICATION
	depends on !LED_INDICATION_DISABLED
	bool "Show an idle pattern instead of turning LEDs off"
	default y

config GNSS_FIX_TIMEOUT_SECONDS
	int "GNSS Fix timeout"
	default 40
	help
	  On each location sample, try for this long to achieve a GNSS fix
	  before falling back to cellular positioning.
	  Set this to 20 or so seconds below the sensor sample interval so
	  that there is time left over to perform cellular positioning.
	  Otherwise, location samples may occur at a longer interval than
	  requested.

config TEST_COUNTER
	bool "Sets whether the test counter is enabled"
	help
	  When enabled, the test counter configuration setting in the shadow is ignored.

config TEST_COUNTER_MULTIPLIER
	int "The number of test counter messages sent on each update"
	default 1
	range 1 1000
	help
	  This is a way to increase the number of device messages sent by the sample.
	  It is useful for load testing.

config AT_CMD_REQUESTS
	depends on !NRF_CLOUD_COAP
	bool "Enables remote execution of AT commands using device messages"
	default y

config AT_CMD_REQUEST_RESPONSE_BUFFER_LENGTH
	int "Max length (in bytes) for Modem responses during AT command requests"
	help
	  Responses to modem AT commands are stored in a buffer of this length before being sent to
	  nRF Cloud. If a response from the modem exceeds this length, it will be dropped, and an
	  error code sent in its place (-NRF_E2BIG). Cannot be less than 40 bytes.
	default 200

if NRF_CLOUD_COAP

menuconfig COAP_FOTA
	bool "FOTA service when using CoAP to connect to nRF Cloud"
	select FOTA_DOWNLOAD
	select FOTA_DOWNLOAD_PROGRESS_EVT
	select IMG_ERASE_PROGRESSIVELY
	select DFU_TARGET
	select DOWNLOAD_CLIENT
	select REBOOT
	select CJSON_LIB
	select SETTINGS
	default y

if COAP_FOTA

config COAP_FOTA_JOB_CHECK_RATE_MINUTES
	int "FOTA job check interval (minutes)"
	default 60
	help
	  Sets the time to wait between each request to get any pending FOTA job.

config COAP_FOTA_THREAD_STACK_SIZE
	int "CoAP FOTA Thread Stack Size (bytes)"
	default 2048
	help
	  Sets the stack size (in bytes) for the CoAP FOTA thread of the
	  sample.

endif

menuconfig COAP_SHADOW
	bool "Updating shadow service"
	default y
	help
	  Updates the shadow with device information. Checks for a shadow
	  delta periodically and processes it if received.

if COAP_SHADOW

config COAP_SHADOW_CHECK_RATE_SECONDS
	int "Shadow job check interval (seconds)"
	default 300
	help
	  Sets the time to wait between each request to get any change to the
	  device shadow.

config COAP_SHADOW_THREAD_STACK_SIZE
	int "CoAP Shadow Thread Stack Size (bytes)"
	default 3072
	help
	  Sets the stack size (in bytes) for the CoAP shadow thread of the
	  sample.

endif

config COAP_SEND_CONFIRMABLE
	bool "Send device messages as confirmable"
	help
	  Ensures all CoAP transfers, even for often less important messages such
	  as sensor data, are sent as confirmable messages.

endif

endmenu

if NRF_CLOUD_MQTT
module-str = MQTT Multi Service
endif
if NRF_CLOUD_COAP
module-str = CoAP Multi Service
endif
module = MULTI_SERVICE
source "${ZEPHYR_BASE}/subsys/logging/Kconfig.template.log_config"

menu "Zephyr Kernel"
source "Kconfig.zephyr"
endmenu
```

## prj.conf
```kconfig
#
# Copyright (c) 2022 Nordic Semiconductor ASA
#
# SPDX-License-Identifier: LicenseRef-Nordic-5-Clause
#

# Log level
# For more verbose and detailed log output, set the log level to
# CONFIG_MULTI_SERVICE_LOG_LEVEL_DBG=y instead.
CONFIG_MULTI_SERVICE_LOG_LEVEL_INF=y

# General config
CONFIG_EVENTS=y
CONFIG_PICOLIBC_IO_FLOAT=y
CONFIG_RESET_ON_FATAL_ERROR=y
CONFIG_NCS_SAMPLES_DEFAULTS=y

# LED indication
# Uncomment these to minimize LED state indication when power savings are necessary
# CONFIG_LED_VERBOSE_INDICATION=n
# CONFIG_LED_CONTINUOUS_INDICATION=n

# Or, uncomment this to completely disable LED state indication
# CONFIG_LED_INDICATION_DISABLED=y

# Improved Logging
# CONFIG_LOG_MODE_DEFERRED allows logging from multiple threads simultaneously without creating
# splintered log entries, at the cost of needing a buffer for storing logs.
CONFIG_LOG_MODE_DEFERRED=y

# CONFIG_LOG_BUFFER_SIZE is the aforementioned buffer. A size of 4096 bytes is useful for debugging
# and prototyping, but is probably more than necessary for production-ready firmware.
CONFIG_LOG_BUFFER_SIZE=4096

# Heap and stacks
# Extended AT host/monitor stack/heap sizes since some nrf_cloud credentials are longer than 1024 bytes.
CONFIG_AT_MONITOR_HEAP_SIZE=2048
CONFIG_AT_HOST_STACK_SIZE=2048
# Extended memory heap size needed both for PGPS and for encoding JSON-based nRF Cloud Device Messages.
CONFIG_HEAP_MEM_POOL_SIZE=19000
CONFIG_SYSTEM_WORKQUEUE_STACK_SIZE=4096

# Enable Networking and Connection Manager.
CONFIG_NETWORKING=y
CONFIG_NET_SOCKETS=y
CONFIG_NET_SOCKETS_OFFLOAD=y
CONFIG_NET_MGMT_EVENT_STACK_SIZE=2048
CONFIG_NET_CONNECTION_MANAGER_MONITOR_STACK_SIZE=1024
CONFIG_MAIN_STACK_SIZE=2048

# Enable LTE Connectivity using Connection Manager
CONFIG_NET_IPV4=y
CONFIG_NET_IPV6=y
CONFIG_NET_IPV6_NBR_CACHE=n
CONFIG_NET_IPV6_MLD=n
CONFIG_NET_CONNECTION_MANAGER=y
CONFIG_NRF_MODEM_LIB_NET_IF=y
CONFIG_NRF_MODEM_LIB_NET_IF_AUTO_DOWN=y
CONFIG_NRF_MODEM_LIB_NET_IF_DOWN_DEFAULT_LTE_DISCONNECT=y

# Enable power savings mode
CONFIG_LTE_PSM_REQ=y
# Set the PSM Requested Active Time to 20 seconds
CONFIG_LTE_PSM_REQ_RAT="00001010"

# Modem library
CONFIG_NRF_MODEM_LIB=y

# AT commands interface
CONFIG_UART_INTERRUPT_DRIVEN=y
CONFIG_AT_HOST_LIBRARY=y

# nRF Cloud
CONFIG_NRF_CLOUD_MQTT=y # This also enables FOTA by implicitly setting CONFIG_NRF_CLOUD_FOTA=y

# MQTT
CONFIG_MQTT_KEEPALIVE=120

# MCUBOOT - Needed by FOTA
CONFIG_BOOTLOADER_MCUBOOT=y
CONFIG_IMG_MANAGER=y
CONFIG_MCUBOOT_IMG_MANAGER=y
CONFIG_STREAM_FLASH_ERASE=y

# Location Services configuration
CONFIG_LOCATION=y
CONFIG_LOCATION_METHOD_GNSS=y
CONFIG_LOCATION_METHOD_CELLULAR=y
CONFIG_NRF_CLOUD_AGNSS=y
CONFIG_NRF_CLOUD_LOCATION=y
CONFIG_MODEM_INFO=y
CONFIG_MODEM_INFO_ADD_NETWORK=y
CONFIG_NRF_CLOUD_PGPS=n
#CONFIG_NRF_CLOUD_PGPS_REPLACEMENT_THRESHOLD=4
#CONFIG_NRF_CLOUD_PGPS_REQUEST_UPON_INIT=y

# Date Time lib - Used by PGPS and main application
CONFIG_DATE_TIME=y

# LTE link control - used by PGPS and main application
CONFIG_LTE_LINK_CONTROL=y

# Settings - used by nRF Cloud library and PGPS
CONFIG_SETTINGS=y
CONFIG_SETTINGS_FCB=y
CONFIG_FCB=y

# Download Client - used by FOTA and PGPS
CONFIG_DOWNLOAD_CLIENT=y
CONFIG_DOWNLOAD_CLIENT_HTTP_FRAG_SIZE_1024=y
CONFIG_DOWNLOAD_CLIENT_STACK_SIZE=4096
CONFIG_DOWNLOAD_CLIENT_BUF_SIZE=2300
CONFIG_DOWNLOAD_CLIENT_MAX_HOSTNAME_SIZE=128

# Flash - Used by FOTA and PGPS
CONFIG_FLASH=y
CONFIG_FLASH_PAGE_LAYOUT=y
CONFIG_FLASH_MAP=y
CONFIG_STREAM_FLASH=y
CONFIG_MPU_ALLOW_FLASH_WRITE=y
CONFIG_PM_EXTERNAL_FLASH_MCUBOOT_SECONDARY=n
CONFIG_NRF_CLOUD_ALERT=y
CONFIG_NRF_CLOUD_LOG_DIRECT=y
CONFIG_NRF_CLOUD_LOG_OUTPUT_LEVEL=3

# On initial connection to the cloud, add info sections to the shadow
CONFIG_NRF_CLOUD_SEND_DEVICE_STATUS=y
CONFIG_NRF_CLOUD_SEND_DEVICE_STATUS_NETWORK=y
CONFIG_NRF_CLOUD_SEND_DEVICE_STATUS_SIM=y
CONFIG_NRF_CLOUD_SEND_SERVICE_INFO_FOTA=y
CONFIG_NRF_CLOUD_SEND_SERVICE_INFO_UI=y

CONFIG_NRF_CLOUD_CLIENT_ID_SRC_INTERNAL_UUID=y
CONFIG_NRF_CLOUD_LOG_LEVEL_INF=y
CONFIG_MODEM_JWT=y
```

## overlay-coap_nrf_provisioning.conf
```kconfig
#
# Copyright (c) 2024 Nordic Semiconductor ASA
#
# SPDX-License-Identifier: LicenseRef-Nordic-5-Clause
#

# Enable provisioning library/provisioning shell dependencies
CONFIG_MODEM_JWT=y
CONFIG_MODEM_ATTEST_TOKEN=y

# Enable the provisioning library
CONFIG_NRF_PROVISIONING=y
CONFIG_NRF_PROVISIONING_AUTO_INIT=n
CONFIG_NRF_PROVISIONING_COAP=y

# Enable provisioning shell
CONFIG_SHELL=y
CONFIG_NRF_PROVISIONING_SHELL=y

# Wait for credential installation to be complete before connecting to nRF Cloud
CONFIG_NRF_CLOUD_CHECK_CREDENTIALS=y

# Adjust shell buffer sizes to handle nRF Cloud certs
CONFIG_SHELL_BACKEND_SERIAL_RX_RING_BUFFER_SIZE=4096
CONFIG_SHELL_CMD_BUFF_SIZE=4096
CONFIG_SHELL_BACKEND_SERIAL_API_INTERRUPT_DRIVEN=y

# Disable AT host and switch to using shell
CONFIG_AT_HOST_LIBRARY=n
CONFIG_AT_SHELL=y
CONFIG_SHELL_WILDCARD=n

# Configure provisioning message formatting
CONFIG_NRF_PROVISIONING_CODEC=y
CONFIG_NRF_PROVISIONING_CBOR=y
CONFIG_ZCBOR=y

# Include provisioning service certificate as part of the binary.
# Used only if none has been provisioned
CONFIG_NRF_PROVISIONING_WITH_CERT=y
CONFIG_NRF_PROVISIONING_ROOT_CA_SEC_TAG=42
CONFIG_NRF_CLOUD_CLIENT_ID_SRC_INTERNAL_UUID=y

# Max provisioning commands per response
CONFIG_NRF_PROVISIONING_CBOR_RECORDS=20

# Set the provisioning interval to 60 seconds.
# This is a very frequent interval. To save power, set this to something approaching 24 hours.
# But note that provisioning may take up to twice as long as this interval, since it
# happens in two steps.
CONFIG_NRF_PROVISIONING_INTERVAL_S=3600

# Request spread factor
CONFIG_NRF_PROVISIONING_SPREAD_S=5

# Adjust provisioning and buffer sizes to handle nRF Cloud certs
CONFIG_NRF_PROVISIONING_RX_BUF_SZ=4096
CONFIG_NRF_PROVISIONING_TX_BUF_SZ=4096
CONFIG_NRF_PROVISIONING_CODEC_AT_CMD_LEN=2048
CONFIG_NRF_PROVISIONING_CODEC_RX_SZ_START=2048

# CoAP Client
CONFIG_COAP_EXTENDED_OPTIONS_LEN=y
CONFIG_COAP_EXTENDED_OPTIONS_LEN_VALUE=64
CONFIG_COAP_CLIENT_THREAD_PRIORITY=0
CONFIG_COAP_CLIENT_BLOCK_SIZE=1024
CONFIG_COAP_CLIENT_MESSAGE_SIZE=1024
CONFIG_COAP_CLIENT_STACK_SIZE=6144
```

## overlay-http_nrf_provisioning.conf
```kconfig
#
# Copyright (c) 2023 Nordic Semiconductor ASA
#
# SPDX-License-Identifier: LicenseRef-Nordic-5-Clause
#

# Enable provisioning library/provisioning shell dependencies
CONFIG_MODEM_JWT=y
CONFIG_MODEM_ATTEST_TOKEN=y

# Enable the provisioning library
CONFIG_NRF_PROVISIONING=y
CONFIG_NRF_PROVISIONING_AUTO_INIT=n
CONFIG_NRF_PROVISIONING_HTTP=y

# Enable provisioning shell
#CONFIG_SHELL=y
#CONFIG_NRF_PROVISIONING_SHELL=y

# Wait for credential installation to be complete before connecting to nRF Cloud
CONFIG_NRF_CLOUD_CHECK_CREDENTIALS=y

# Adjust shell buffer sizes to handle nRF Cloud certs
#CONFIG_SHELL_BACKEND_SERIAL_RX_RING_BUFFER_SIZE=4096
#CONFIG_SHELL_CMD_BUFF_SIZE=4096

# Disable AT host and switch to using shell
CONFIG_AT_HOST_LIBRARY=y
#CONFIG_AT_SHELL=y
#CONFIG_SHELL_WILDCARD=n

# Configure provisioning message formatting
CONFIG_NRF_PROVISIONING_CODEC=y
CONFIG_NRF_PROVISIONING_CBOR=y
CONFIG_ZCBOR=y
CONFIG_ZCBOR_CANONICAL=y

# Include provisioning service certificate as part of the binary.
# Used only if none has been provisioned
CONFIG_NRF_PROVISIONING_WITH_CERT=y
CONFIG_NRF_PROVISIONING_ROOT_CA_SEC_TAG=50
CONFIG_NRF_CLOUD_CLIENT_ID_SRC_INTERNAL_UUID=y

# Max provisioning commands per response
CONFIG_NRF_PROVISIONING_CBOR_RECORDS=20

# Set the provisioning interval to 60 seconds.
# This is a very frequent interval. To save power, set this to something approaching 24 hours.
# But note that provisioning may take up to twice as long as this interval, since it
# happens in two steps.
CONFIG_NRF_PROVISIONING_INTERVAL_S=60

# Request spread factor
CONFIG_NRF_PROVISIONING_SPREAD_S=5

# Adjust provisioning and buffer sizes to handle nRF Cloud certs
CONFIG_NRF_PROVISIONING_RX_BUF_SZ=4096
CONFIG_NRF_PROVISIONING_TX_BUF_SZ=4096
CONFIG_NRF_PROVISIONING_CODEC_AT_CMD_LEN=2048
CONFIG_NRF_PROVISIONING_CODEC_RX_SZ_START=2048
```

## overlay_coap.conf
```kconfig
#
# Copyright (c) 2022 Nordic Semiconductor ASA
#
# SPDX-License-Identifier: LicenseRef-Nordic-5-Clause
#

# General config
CONFIG_FPU=y
CONFIG_NEWLIB_LIBC_NANO=n

# Rate of cloud interactions
# These are faster than one normally would use in a low power device.
# This is strictly for demo purposes.
CONFIG_SENSOR_SAMPLE_INTERVAL_SECONDS=3600
CONFIG_LOCATION_TRACKING_SAMPLE_INTERVAL_SECONDS=3600
CONFIG_COAP_FOTA_JOB_CHECK_RATE_MINUTES=3600
CONFIG_COAP_SHADOW_CHECK_RATE_SECONDS=30

# Logs
CONFIG_LOG=y
CONFIG_NET_LOG=y
CONFIG_LOG_PRINTK=y
CONFIG_COAP_LOG_LEVEL_INF=y
CONFIG_LOCATION_LOG_LEVEL_INF=y
CONFIG_NRF_CLOUD_COAP_LOG_LEVEL_DBG=y
#CONFIG_NRF_CLOUD_GPS_LOG_LEVEL_DBG=y
CONFIG_MULTI_SERVICE_LOG_LEVEL_INF=y
CONFIG_NRF_CLOUD_CLIENT_ID_SRC_INTERNAL_UUID=y
CONFIG_NRF_CLOUD_LOG_LEVEL_INF=y

# LTE link control - used by PGPS and main application
CONFIG_LTE_LINK_CONTROL=y
#CONFIG_NET_L2_VIRTUAL=y

# Modem
CONFIG_MODEM_KEY_MGMT=y
CONFIG_MODEM_JWT=y
CONFIG_MODEM_INFO_ADD_DEVICE=y
CONFIG_MODEM_INFO_ADD_DATE_TIME=n
CONFIG_MODEM_INFO_ADD_SIM=n
CONFIG_MODEM_INFO_ADD_SIM_ICCID=n
CONFIG_MODEM_INFO_ADD_SIM_IMSI=n

# Network
CONFIG_POSIX_API=y
CONFIG_NET_SOCKETS_TLS_SET_MAX_FRAGMENT_LENGTH=y
CONFIG_NET_SOCKETS_OFFLOAD_PRIORITY=40

# CoAP Client
CONFIG_COAP_CLIENT_BLOCK_SIZE=1024
CONFIG_COAP_CLIENT_STACK_SIZE=6144
CONFIG_COAP_CLIENT_THREAD_PRIORITY=0
CONFIG_COAP_EXTENDED_OPTIONS_LEN_VALUE=64

# Not compatible with ground-fix
CONFIG_ZCBOR_CANONICAL=n

# nRF Cloud
CONFIG_NRF_CLOUD_MQTT=n
CONFIG_NRF_CLOUD_COAP=y
CONFIG_NRF_CLOUD_ALERT=y
CONFIG_NRF_CLOUD_LOG_DIRECT=y
CONFIG_NRF_CLOUD_LOG_OUTPUT_LEVEL=3
CONFIG_NRF_CLOUD_LOG_LOG_LEVEL_INF=y
CONFIG_NRF_CLOUD_FOTA_POLL=y

# Disable MQTT-specific services; equivalent CoAP versions are used instead.
CONFIG_NRF_CLOUD_FOTA=n
CONFIG_NRF_CLOUD_LOCATION=n

# Location Services configuration
CONFIG_LOCATION_DATA_DETAILS=y

CONFIG_APPLICATION_THREAD_STACK_SIZE=4096
CONFIG_TEMP_ALERT_LIMIT=24
```

## overlay_nrfcloud_logging.conf
```kconfig
#
# Copyright (c) 2023 Nordic Semiconductor ASA
#
# SPDX-License-Identifier: LicenseRef-Nordic-5-Clause
#
CONFIG_NRF_CLOUD_LOG_BACKEND=y
CONFIG_NRF_CLOUD_LOG_OUTPUT_LEVEL=3
CONFIG_NRF_CLOUD_LOG_LOG_LEVEL_INF=y
CONFIG_LOG_MODE_DEFERRED=y
CONFIG_NRF_CLOUD_LOG_INCLUDE_LEVEL_0=y

# If enabled, log levels for each log source can be set per log backend, and
# can be changed dynamically.
CONFIG_LOG_RUNTIME_FILTERING=n

CONFIG_LOG_BUFFER_SIZE=4096

# Select which format to generate. Dictionary logs are compact but require
# decoding on the server or user PC. Text logs are verbose but immediately
# visible in the nRF Cloud web portal. Unless you disable UART text logging,
# you must set CONFIG_LOG_FMT_SECTION_STRIP=n when
# CONFIG_LOG_BACKEND_NRF_CLOUD_OUTPUT_DICTIONARY=y, or else you will get a
# build assert warning you to do so. This is to prevent a hard crash at runtime.
#CONFIG_LOG_BACKEND_NRF_CLOUD_OUTPUT_TEXT=y
CONFIG_LOG_BACKEND_NRF_CLOUD_OUTPUT_DICTIONARY=y
#CONFIG_LOG_FMT_SECTION_STRIP=n

CONFIG_LOG_PROCESS_THREAD_STACK_SIZE=4096
CONFIG_LOG_PROCESS_THREAD_SLEEP_MS=30000
CONFIG_TEMP_ALERT_LIMIT=24
```

## src/application.c
```c
/* Copyright (c) 2023 Nordic Semiconductor ASA
 *
 * SPDX-License-Identifier: LicenseRef-Nordic-5-Clause
 */

#include <zephyr/kernel.h>
#include <zephyr/logging/log.h>
#include <zephyr/logging/log_ctrl.h>
#include <date_time.h>
#include <stdio.h>
#include <net/nrf_cloud.h>
#include <net/nrf_cloud_codec.h>
#include <net/nrf_cloud_log.h>
#include <net/nrf_cloud_alert.h>
#if defined(CONFIG_NRF_CLOUD_COAP)
#include <net/nrf_cloud_coap.h>
#endif
#if defined(CONFIG_LOCATION_TRACKING)
#include <modem/location.h>
#include "location_tracking.h"
#endif
#include "application.h"
#include "temperature.h"
#include "cloud_connection.h"
#include "message_queue.h"
#include "led_control.h"
#include "at_commands.h"

LOG_MODULE_REGISTER(application, CONFIG_MULTI_SERVICE_LOG_LEVEL);

/* Timer used to time the sensor sampling rate. */
static K_TIMER_DEFINE(sensor_sample_timer, NULL, NULL);

/* AT command request error handling */
#define AT_CMD_REQUEST_ERR_FORMAT "Error while processing AT command request: %d"
#define AT_CMD_REQUEST_ERR_MAX_LEN (sizeof(AT_CMD_REQUEST_ERR_FORMAT) + 20)
BUILD_ASSERT(CONFIG_AT_CMD_REQUEST_RESPONSE_BUFFER_LENGTH >= AT_CMD_REQUEST_ERR_MAX_LEN,
	     "Not enough AT command response buffer for printing error events.");

/* Temperature alert limits. */
#define TEMP_ALERT_LIMIT ((double)CONFIG_TEMP_ALERT_LIMIT)
#define TEMP_ALERT_HYSTERESIS 1.5
#define TEMP_ALERT_LOWER_LIMIT (TEMP_ALERT_LIMIT - TEMP_ALERT_HYSTERESIS)

/**
 * @brief Construct a device message object with automatically generated timestamp
 *
 * The resultant JSON object will be conformal to the General Message Schema described in the
 * application-protocols repo:
 *
 * https://github.com/nRFCloud/application-protocols
 *
 * @param msg - The object to contain the message
 * @param appid - The appId for the device message
 * @param msg_type - The messageType for the device message
 * @return int - 0 on success, negative error code otherwise.
 */
static int create_timestamped_device_message(struct nrf_cloud_obj *const msg,
					     const char *const appid,
					     const char *const msg_type)
{
	int err;
	int64_t timestamp;

	/* Acquire timestamp */
	err = date_time_now(&timestamp);
	if (err) {
		LOG_ERR("Failed to obtain current time, error %d", err);
		return -ETIME;
	}

	/* Create message object */
	err = nrf_cloud_obj_msg_init(msg, appid,
				     IS_ENABLED(CONFIG_NRF_CLOUD_COAP) ? NULL : msg_type);
	if (err) {
		LOG_ERR("Failed to initialize message with appid %s and msg type %s",
			appid, msg_type);
		return err;
	}

	/* Add timestamp to message object */
	err = nrf_cloud_obj_ts_add(msg, timestamp);
	if (err) {
		LOG_ERR("Failed to add timestamp to data message with appid %s and msg type %s",
			appid, msg_type);
		nrf_cloud_obj_free(msg);
		return err;
	}

	return 0;
}

/**
 * @brief Transmit a collected sensor sample to nRF Cloud.
 *
 * @param sensor - The name of the sensor which was sampled.
 * @param value - The sampled sensor value.
 * @return int - 0 on success, negative error code otherwise.
 */
static int send_sensor_sample(const char *const sensor, double value)
{
	int ret;

	MSG_OBJ_DEFINE(msg_obj);

	/* Create a timestamped message container object for the sensor sample. */
	ret = create_timestamped_device_message(&msg_obj, sensor,
						NRF_CLOUD_JSON_MSG_TYPE_VAL_DATA);
	if (ret) {
		return -EINVAL;
	}

	/* Populate the container object with the sensor value. */
	ret = nrf_cloud_obj_num_add(&msg_obj, NRF_CLOUD_JSON_DATA_KEY, value, false);
	if (ret) {
		LOG_ERR("Failed to append value to %s sample container object ",
			sensor);
		nrf_cloud_obj_free(&msg_obj);
		return -ENOMEM;
	}

	/* Send the sensor sample container object as a device message. */
	return send_device_message(&msg_obj);
}

#if defined(CONFIG_LOCATION_TRACKING)
/**
 * @brief Transmit a collected GNSS sample to nRF Cloud.
 *
 * @param loc_gnss - GNSS location data.
 * @return int - 0 on success, negative error code otherwise.
 */
static int send_gnss(const struct location_event_data * const loc_gnss)
{
	int ret;

	if (!loc_gnss || (loc_gnss->method != LOCATION_METHOD_GNSS)) {
		return -EINVAL;
	}

	struct nrf_cloud_gnss_data gnss_pvt = {
		.type = NRF_CLOUD_GNSS_TYPE_PVT,
		.ts_ms = NRF_CLOUD_NO_TIMESTAMP,
		.pvt = {
			.lon		= loc_gnss->location.longitude,
			.lat		= loc_gnss->location.latitude,
			.accuracy	= loc_gnss->location.accuracy,
			.has_alt	= 0,
			.has_speed	= 0,
			.has_heading	= 0
		}
	};
	MSG_OBJ_DEFINE(msg_obj);

	/* Add the timestamp */
	(void)date_time_now(&gnss_pvt.ts_ms);

	/* Encode the location data into a device message */
	ret = nrf_cloud_obj_gnss_msg_create(&msg_obj, &gnss_pvt);

	if (ret == 0) {
		/* Send the location message */
		ret = send_device_message(&msg_obj);
	}

	return ret;
}

/**
 * @brief Callback to receive periodic location updates from location_tracking.c and forward them
 * to nRF Cloud.
 *
 * Note that cellular positioning (MCELL/Multi-Cell and SCELL/Single-Cell) is sent to nRF
 * Cloud automatically (since the Location library and nRF Cloud must work together to
 * determine them in the first place). GNSS positions, on the other hand, must be
 * sent manually, since they are determined entirely on-device.
 *
 * @param location_data - The received location update.
 *
 */
static void on_location_update(const struct location_event_data * const location_data)
{
	LOG_INF("Location Updated: %.06f N %.06f W, accuracy: %.01f m, Method: %s",
		location_data->location.latitude,
		location_data->location.longitude,
		(double)location_data->location.accuracy,
		location_method_str(location_data->method));

	/* If the position update was derived using GNSS, send it onward to nRF Cloud. */
	if (location_data->method == LOCATION_METHOD_GNSS) {
		LOG_INF("GNSS Position Update! Sending to nRF Cloud...");
		send_gnss(location_data);
	}
}
#endif /* CONFIG_LOCATION_TRACKING */

/**
 * @brief Receives general device messages from nRF Cloud, checks if they are AT command requests,
 * and performs them if so, transmitting the modem response back to nRF Cloud.
 *
 * Try sending {"appId":"MODEM", "messageType":"CMD", "data":"AT+CGMR"}
 * in the nRF Cloud Portal Terminal card.
 *
 * @param msg - The device message to check.
 */
static void handle_at_cmd_requests(const struct nrf_cloud_data *const dev_msg)
{
	char *cmd;
	struct nrf_cloud_obj msg_obj;
	int err = nrf_cloud_obj_input_decode(&msg_obj, dev_msg);

	if (err) {
		/* The message isn't JSON or otherwise couldn't be parsed. */
		LOG_DBG("A general topic device message of length %d could not be parsed.",
			dev_msg->len);
		return;
	}

	/* Confirm app ID and message type */
	err = nrf_cloud_obj_msg_check(&msg_obj, NRF_CLOUD_JSON_APPID_VAL_MODEM,
				      NRF_CLOUD_JSON_MSG_TYPE_VAL_CMD);
	if (err) {
		goto cleanup;
	}

	/* Get the command string */
	err = nrf_cloud_obj_str_get(&msg_obj, NRF_CLOUD_JSON_DATA_KEY, &cmd);
	if (err) {
		/* Missing or invalid command value will be treated as a blank command */
		cmd = "";
	}

	/* Execute the command and receive the result */
	char *response = execute_at_cmd_request(cmd);

	/* To re-use msg_obj for the response message we must first free its memory and
	 * reset its state.
	 * The cmd string will no longer be valid after msg_obj is freed.
	 */
	cmd = NULL;
	/* Free the object's allocated memory */
	err = nrf_cloud_obj_free(&msg_obj);
	if (err) {
		LOG_ERR("Failed to free AT CMD request");
		return;
	}

	/* Reset the object's state */
	err = nrf_cloud_obj_reset(&msg_obj);
	if (err) {
		LOG_ERR("Failed to reset AT CMD request message object for reuse");
		return;
	}

	err = create_timestamped_device_message(&msg_obj, NRF_CLOUD_JSON_APPID_VAL_MODEM,
						NRF_CLOUD_JSON_MSG_TYPE_VAL_DATA);
	if (err) {
		return;
	}

	/* Populate response with command result */
	err = nrf_cloud_obj_str_add(&msg_obj, NRF_CLOUD_JSON_DATA_KEY, response, false);
	if (err) {
		LOG_ERR("Failed to populate AT CMD response with modem response data");
		goto cleanup;
	}

	/* Send the response */
	err = send_device_message(&msg_obj);
	if (err) {
		LOG_ERR("Failed to send AT CMD request response, error: %d", err);
	}

	return;

cleanup:
	(void)nrf_cloud_obj_free(&msg_obj);
}

/** @brief Check whether temperature is acceptable.
 * If the device exceeds a temperature limit, send the temperature alert one time.
 * Once the temperature falls below a lower limit, re-enable the temperature alert
 * so it will be sent if limit is exceeded again.
 *
 * The difference between the two limits should be sufficient to prevent sending
 * new alerts if the temperature value oscillates between two nearby values.
 *
 * @param temp - The current device temperature.
 */
static void monitor_temperature(double temp)
{
	static bool temperature_alert_active;

	if ((temp > TEMP_ALERT_LIMIT) && !temperature_alert_active) {
		temperature_alert_active = true;
		(void)nrf_cloud_alert_send(ALERT_TYPE_TEMPERATURE, (float)temp,
					   "Temperature over limit!");
		LOG_INF("Temperature limit %f C exceeded: now %f C.",
			TEMP_ALERT_LIMIT, temp);
	} else if ((temp < TEMP_ALERT_LOWER_LIMIT) && temperature_alert_active) {
		temperature_alert_active = false;
		LOG_INF("Temperature now below limit: %f C.", temp);
	}
}

void main_application_thread_fn(void)
{
	if (IS_ENABLED(CONFIG_AT_CMD_REQUESTS)) {
		/* Register with connection.c to receive general device messages and check them for
		 * AT command requests.
		 */
		register_general_dev_msg_handler(handle_at_cmd_requests);
	}

	/* Wait for first connection before starting the application. */
	(void)await_cloud_ready(K_FOREVER);

	(void)nrf_cloud_alert_send(ALERT_TYPE_DEVICE_NOW_ONLINE, 0, NULL);

	/* Wait for the date and time to become known.
	 * This is needed both for location services and for sensor sample timestamping.
	 */
	LOG_INF("Waiting for modem to determine current date and time");
	if (!await_date_time_known(K_SECONDS(CONFIG_DATE_TIME_ESTABLISHMENT_TIMEOUT_SECONDS))) {
		LOG_WRN("Failed to determine valid date time. Proceeding anyways");
	} else {
		LOG_INF("Current date and time determined");
	}

	const char *protocol = "";

	if (IS_ENABLED(CONFIG_NRF_CLOUD_MQTT)) {
		protocol = "MQTT";
	} else if (IS_ENABLED(CONFIG_NRF_CLOUD_COAP)) {
		protocol = "CoAP";
	}
	nrf_cloud_log_init();
	nrf_cloud_log_control_set(CONFIG_NRF_CLOUD_LOG_OUTPUT_LEVEL);
	/* Send a direct log to the nRF Cloud web portal indicating the sample has started up. */
	(void)nrf_cloud_log_send(LOG_LEVEL_INF,
				 "nRF Cloud multi-service sample has started, "
				 "version: %s, protocol: %s",
				 CONFIG_APP_VERSION, protocol);

#if defined(CONFIG_LOCATION_TRACKING)
	/* Begin tracking location at the configured interval. */
	(void)start_location_tracking(on_location_update,
					CONFIG_LOCATION_TRACKING_SAMPLE_INTERVAL_SECONDS);
#endif
	int counter = 0;

#if defined(CONFIG_NRF_CLOUD_COAP)
	int err;
	uint8_t buf[64];
	int64_t start = k_uptime_get();

	for (int i = 8; i < 64; i++) {
		buf[i] = 0x5a ^ i;
	}
#endif

	/* Begin sampling sensors. */
	while (true) {
		/* Start the sensor sample interval timer.
		 * We use a timer here instead of merely sleeping the thread, because the
		 * application thread can be preempted by other threads performing long tasks
		 * (such as periodic location acquisition), and we want to account for these
		 * delays when metering the sample send rate.
		 */
		k_timer_start(&sensor_sample_timer,
			K_SECONDS(CONFIG_SENSOR_SAMPLE_INTERVAL_SECONDS), K_FOREVER);

		if (IS_ENABLED(CONFIG_TEMP_TRACKING)) {
			double temp = -1;

			if (get_temperature(&temp) == 0) {
				LOG_INF("Temperature is %d degrees C", (int)temp);
				(void)send_sensor_sample(NRF_CLOUD_JSON_APPID_VAL_TEMP, temp);

				monitor_temperature(temp);
			}
		}

		if (IS_ENABLED(CONFIG_TEST_COUNTER)) {
			LOG_INF("Sent test counter = %d", counter);
			(void)send_sensor_sample("COUNT", counter++);
		}

#if defined(CONFIG_NRF_CLOUD_COAP)
		*((int64_t *)buf) = k_uptime_delta(&start);
		err = nrf_cloud_coap_bytes_send(buf, sizeof(buf), true);
		if (err) {
			LOG_ERR("Error sending binary data: %d", err);
		}
#endif

		/* Wait out any remaining time on the sample interval timer. */
		k_timer_status_sync(&sensor_sample_timer);
	}
}
```

## src/cloud_connection.c
```c
/* Copyright (c) 2023 Nordic Semiconductor ASA
 *
 * SPDX-License-Identifier: LicenseRef-Nordic-5-Clause
 */

#include <zephyr/kernel.h>
#include <zephyr/net/socket.h>
#include <zephyr/logging/log.h>
#include <stdio.h>
#include <date_time.h>
#include <net/nrf_cloud.h>
#include <net/nrf_cloud_log.h>
#if defined(CONFIG_NRF_CLOUD_COAP)
#include <net/nrf_cloud_coap.h>
#include "fota_support_coap.h"
#endif

#include "cloud_connection.h"
#include "fota_support.h"
#include "location_tracking.h"
#include "led_control.h"

LOG_MODULE_REGISTER(cloud_connection, CONFIG_MULTI_SERVICE_LOG_LEVEL);

/* Internal state */

/* Pendable events that threads can wait for. */
#define NETWORK_READY			BIT(0)
#define CLOUD_READY			BIT(1)
#define CLOUD_DISCONNECTED		BIT(2)
#define DATE_TIME_KNOWN			BIT(3)
static K_EVENT_DEFINE(cloud_events);

/* Atomic status flag tracking whether an initial association is in progress. */
atomic_t initial_association;

static void cloud_ready(void);
static void update_shadow(void);

/* Helper functions for pending on pendable events. */
bool await_network_ready(k_timeout_t timeout)
{
	return k_event_wait(&cloud_events, NETWORK_READY, false, timeout) != 0;
}

bool await_cloud_ready(k_timeout_t timeout)
{
	return k_event_wait(&cloud_events, CLOUD_READY, false, timeout) != 0;
}

bool await_cloud_disconnected(k_timeout_t timeout)
{
	return k_event_wait(&cloud_events, CLOUD_DISCONNECTED, false, timeout) != 0;
}

bool await_date_time_known(k_timeout_t timeout)
{
	return k_event_wait(&cloud_events, DATE_TIME_KNOWN, false, timeout) != 0;
}

/* Delayable work item for handling cloud readiness timeout.
 * The work item is scheduled at a delay any time connection starts and is cancelled when the
 * connection to nRF Cloud becomes ready to use (signalled by NRF_CLOUD_EVT_READY).
 *
 * If the work item executes, that means the nRF Cloud connection did not become ready for use
 * within the delay, and thus the connection should be reset (and then try again later).
 */
static void ready_timeout_work_fn(struct k_work *work)
{
	ARG_UNUSED(work);
	LOG_INF("nRF Cloud connection did not become ready in time, disconnecting and retrying...");
	disconnect_cloud();
}

static K_WORK_DELAYABLE_DEFINE(ready_timeout_work, ready_timeout_work_fn);

static void start_readiness_timeout(void)
{
	LOG_DBG("Starting cloud connection readiness timeout for %d seconds",
		CONFIG_CLOUD_READY_TIMEOUT_SECONDS);
	k_work_reschedule(&ready_timeout_work, K_SECONDS(CONFIG_CLOUD_READY_TIMEOUT_SECONDS));
}

static void clear_readiness_timeout(void)
{
	LOG_DBG("Stopping cloud connection readiness timeout");
	k_work_cancel_delayable(&ready_timeout_work);
}

/* A callback that the application may register in order to handle custom device messages.
 * This is really a convenience callback to help keep this sample clean and modular. You could
 * implement device message handling directly in the cloud_event_handler if desired.
 */
static dev_msg_handler_cb_t general_dev_msg_handler;
void register_general_dev_msg_handler(dev_msg_handler_cb_t handler_cb)
{
	general_dev_msg_handler = handler_cb;
}

/* This function causes the cloud to disconnect, and updates internal state accordingly.
 *
 * It is also triggerd by cloud disconnection, to update internal state.
 *
 * In this latter case, an unnecessary "Disconnecting from nRF Cloud" and
 * "Already disconnected from nRF Cloud" will be printed.
 *
 * This is done to keep the sample simple, though the log messages may be a bit confusing.
 */
void disconnect_cloud(void)
{
	/* Clear the readiness timeout in case it was running. */
	clear_readiness_timeout();

	/* Clear the Ready event, no longer accurate. */
	k_event_clear(&cloud_events, CLOUD_READY);

	/* Clear the initial association flag, no longer accurate. */
	atomic_set(&initial_association, false);

	/* Disconnect from nRF Cloud -- Blocking call
	 * Will no-op and return -EACCES if already disconnected.
	 */
	LOG_INF("Disconnecting from nRF Cloud");
	int err;

#if defined(CONFIG_NRF_CLOUD_MQTT)
	err = nrf_cloud_disconnect();
#elif defined(CONFIG_NRF_CLOUD_COAP)
	err = nrf_cloud_coap_disconnect();
#endif
	/* nrf_cloud_uninit returns -EACCES if we are not currently in a connected state. */
	if (err == -EACCES) {
		LOG_DBG("Already disconnected from nRF Cloud");
	} else if (err) {
		LOG_ERR("Cannot disconnect from nRF Cloud, error: %d. Continuing anyways", err);
	} else {
		LOG_INF("Successfully disconnected from nRF Cloud");
	}

	/* Fire the disconnected event. */
	k_event_post(&cloud_events, CLOUD_DISCONNECTED);
}

/**
 * @brief Attempt to connect to nRF Cloud and update internal state accordingly.
 *
 * @retval true if successful
 * @retval false if connection failed
 */
static bool connect_cloud(void)
{
	LOG_INF("Connecting to nRF Cloud");

	/* Clear the disconnected flag, no longer accurate. */
	k_event_clear(&cloud_events, CLOUD_DISCONNECTED);

	int err;

#if defined(CONFIG_NRF_CLOUD_MQTT)
	/* Connect to nRF Cloud -- Non-blocking. State updates are handled in callbacks. */
	err = nrf_cloud_connect();
#elif defined(CONFIG_NRF_CLOUD_COAP)
	/* Connect via CoAP -- blocking. */
	err = nrf_cloud_coap_connect(CONFIG_APP_VERSION);
	if (!err) {
		cloud_ready();
		update_shadow();
		return true;
	}
#endif

	/* If we were already connected, treat as a successful connection, but do nothing. */
	if (err == NRF_CLOUD_CONNECT_RES_ERR_ALREADY_CONNECTED) {
		LOG_WRN("Already connected to nRF Cloud");
		return true;
	}

	/* If the connection attempt fails, report and exit. */
	if (err != 0) {
		LOG_ERR("Could not connect to nRF Cloud, error: %d", err);
		return false;
	}

	/* If the connect attempt succeeded, start the readiness timeout. */
	LOG_INF("Connected to nRF Cloud");
	start_readiness_timeout();
	return true;
}

/**
 * @brief Update internal state in response to achieving readiness.
 */
static void cloud_ready(void)
{
	/* Clear the readiness timeout, since we have become ready. */
	clear_readiness_timeout();

	/* Notify that the nRF Cloud connection is ready for use. */
	k_event_post(&cloud_events, CLOUD_READY);
}

/**
 * @brief Updates the nRF Cloud shadow with information about supported capabilities, current
 *  firmware running, FOTA support, and so on.
 */
static void update_shadow(void)
{
	static bool updated;
	int err;
	struct nrf_cloud_svc_info_fota fota_info = {
		.application = nrf_cloud_fota_is_type_enabled(NRF_CLOUD_FOTA_APPLICATION),
		.bootloader = nrf_cloud_fota_is_type_enabled(NRF_CLOUD_FOTA_BOOTLOADER),
		.modem = nrf_cloud_fota_is_type_enabled(NRF_CLOUD_FOTA_MODEM_DELTA),
		.modem_full = nrf_cloud_fota_is_type_enabled(NRF_CLOUD_FOTA_MODEM_FULL)
	};
	struct nrf_cloud_svc_info_ui ui_info = {
		.gnss = location_tracking_enabled(),
		.temperature = IS_ENABLED(CONFIG_TEMP_TRACKING),
		.log = nrf_cloud_is_text_logging_enabled(),
		.dictionary_log = nrf_cloud_is_dict_logging_enabled()
	};
	struct nrf_cloud_svc_info service_info = {
		.fota = &fota_info,
		.ui = &ui_info
	};
	struct nrf_cloud_device_status device_status = {
		.modem = NULL,
		.svc = &service_info,
		.conn_inf = NRF_CLOUD_INFO_NO_CHANGE
	};

	if (updated) {
		return; /* It is not necessary to do this more than once per boot. */
	}
	LOG_DBG("Updating shadow");
#if defined(CONFIG_NRF_CLOUD_MQTT)
	err = nrf_cloud_shadow_device_status_update(&device_status);
#elif defined(CONFIG_NRF_CLOUD_COAP)
	err = nrf_cloud_coap_shadow_device_status_update(&device_status);
#endif

	if (err) {
		LOG_ERR("Failed to update device shadow, error: %d", err);
	} else {
		LOG_DBG("Updated shadow");
		updated = true;
	}
}

/* External event handlers */

/* Handler for L4/connectivity events
 * This allows the cloud module to react to network gain and loss.
 * The conn_mgr subsystem is responsible for seeking / maintaining network connectivity and
 * firing these events.
 */
struct net_mgmt_event_callback l4_callback;
static void l4_event_handler(struct net_mgmt_event_callback *cb,
			     uint32_t event, struct net_if *iface)
{
	if (event == NET_EVENT_L4_CONNECTED) {
		LOG_INF("Network connectivity gained!");

		k_sleep(K_MSEC(1000));

		/* Set the network ready flag */
		k_event_post(&cloud_events, NETWORK_READY);

		/* If LTE-event-driven date_time updates are disabled, manually trigger a date_time
		 * timestamp refresh.
		 *
		 * Note: The CONFIG_DATE_TIME_AUTO_UPDATE setting controls specifically whether
		 * LTE-event-driven date_time updates are enabled. The date_time library will still
		 * periodically refresh its timestamp if CONFIG_DATE_TIME_AUTO_UPDATE is disabled,
		 * but this refresh is infrequent, so we are manually requesting a refresh
		 * whenever internet access becomes available so that we get a timestamp
		 * immediately.
		 */
		if (!IS_ENABLED(CONFIG_DATE_TIME_AUTO_UPDATE)) {
			date_time_update_async(NULL);
		}

	} else if (event == NET_EVENT_L4_DISCONNECTED) {
		LOG_INF("Network connectivity lost!");

		/* Clear the network ready flag */
		k_event_clear(&cloud_events, NETWORK_READY);

		/* Disconnect from cloud as well. */
		disconnect_cloud();
	}
}

/* Handler for date_time library events, used to keep track of whether the current time is known */
static void date_time_event_handler(const struct date_time_evt *date_time_evt)
{
	if (date_time_is_valid()) {
		k_event_post(&cloud_events, DATE_TIME_KNOWN);
	} else {
		k_event_clear(&cloud_events, DATE_TIME_KNOWN);
	}
}

#if defined(CONFIG_NRF_CLOUD_MQTT)
/* Handler for events from nRF Cloud Lib. */
static void cloud_event_handler(const struct nrf_cloud_evt *nrf_cloud_evt)
{
	switch (nrf_cloud_evt->type) {
	case NRF_CLOUD_EVT_TRANSPORT_CONNECTED:
		LOG_DBG("NRF_CLOUD_EVT_TRANSPORT_CONNECTED");
		/* There isn't much to do here since what we really care about is association! */
		break;
	case NRF_CLOUD_EVT_TRANSPORT_CONNECTING:
		LOG_DBG("NRF_CLOUD_EVT_TRANSPORT_CONNECTING");
		break;
	case NRF_CLOUD_EVT_TRANSPORT_CONNECT_ERROR:
		LOG_DBG("NRF_CLOUD_EVT_TRANSPORT_CONNECT_ERROR: %d", nrf_cloud_evt->status);

		/* Disconnect from cloud immediately rather than wait for retry timeout. */
		disconnect_cloud();

		break;
	case NRF_CLOUD_EVT_USER_ASSOCIATION_REQUEST:
		LOG_DBG("NRF_CLOUD_EVT_USER_ASSOCIATION_REQUEST");
		/* This event indicates that the user must associate the device with their
		 * nRF Cloud account in the nRF Cloud portal.
		 *
		 * The device must then disconnect and reconnect to nRF Cloud after association
		 * succeeds.
		 */
		LOG_INF("Please add this device to your cloud account in the nRF Cloud portal.");

		/* Store the fact that this is an initial association.
		 *
		 * This will cause the next NRF_CLOUD_EVT_USER_ASSOCIATED event to
		 * disconnect and reconnect the device to nRF Cloud, which is required
		 * when devices are first associated with an nRF Cloud account.
		 */
		atomic_set(&initial_association, true);
		break;
	case NRF_CLOUD_EVT_USER_ASSOCIATED:
		LOG_DBG("NRF_CLOUD_EVT_USER_ASSOCIATED");
		/* Indicates successful association with an nRF Cloud account.
		 * Fired every time the device connects (unless the device is not associated).
		 *
		 * If this is an initial association, the device must disconnect and
		 * and reconnect before using nRF Cloud.
		 */

		if (atomic_get(&initial_association)) {
			/* Disconnect as is required.
			 * The connection loop will handle reconnection afterwards.
			 */
			LOG_INF("Device successfully associated with cloud! Reconnecting");
			disconnect_cloud();
		}
		break;
	case NRF_CLOUD_EVT_READY:
		LOG_DBG("NRF_CLOUD_EVT_READY");

		/* Handle achievement of readiness */
		cloud_ready();

		/* Update the device shadow */
		update_shadow();

		break;
	case NRF_CLOUD_EVT_SENSOR_DATA_ACK:
		LOG_DBG("NRF_CLOUD_EVT_SENSOR_DATA_ACK");
		break;
	case NRF_CLOUD_EVT_TRANSPORT_DISCONNECTED:
		LOG_DBG("NRF_CLOUD_EVT_TRANSPORT_DISCONNECTED");

		/* The nRF Cloud library itself has disconnected for some reason.
		 * Execute a manual disconnect so that the event flags are updated.
		 * The internal nrf_cloud_disconnect call will no-op.
		 */
		disconnect_cloud();

		break;
	case NRF_CLOUD_EVT_ERROR:
		LOG_DBG("NRF_CLOUD_EVT_ERROR: %d", nrf_cloud_evt->status);
		break;
	case NRF_CLOUD_EVT_RX_DATA_GENERAL:
		LOG_DBG("NRF_CLOUD_EVT_RX_DATA_GENERAL");
		LOG_DBG("%d bytes received from cloud", nrf_cloud_evt->data.len);

		/* Pass the device message along to the application, if it is listening */
		if (general_dev_msg_handler) {
			/* To keep the sample simple, we invoke the callback directly.
			 * If you want to do complex operations in this callback without blocking
			 * receipt of data from nRF Cloud, you should set up a work queue and pass
			 * messages to it either here, or from inside the callback.
			 */
			general_dev_msg_handler(&nrf_cloud_evt->data);
		}

		break;
	case NRF_CLOUD_EVT_RX_DATA_SHADOW:
		LOG_DBG("NRF_CLOUD_EVT_RX_DATA_SHADOW");
		break;
	case NRF_CLOUD_EVT_FOTA_START:
		LOG_DBG("NRF_CLOUD_EVT_FOTA_START");
		break;
	case NRF_CLOUD_EVT_FOTA_DONE: {
		enum nrf_cloud_fota_type fota_type = NRF_CLOUD_FOTA_TYPE__INVALID;

		if (nrf_cloud_evt->data.ptr) {
			fota_type = *((enum nrf_cloud_fota_type *) nrf_cloud_evt->data.ptr);
		}

		LOG_DBG("NRF_CLOUD_EVT_FOTA_DONE, FOTA type: %s",
			fota_type == NRF_CLOUD_FOTA_APPLICATION	  ?		"Application"	:
			fota_type == NRF_CLOUD_FOTA_MODEM_DELTA	  ?		"Modem (delta)"	:
			fota_type == NRF_CLOUD_FOTA_MODEM_FULL	  ?		"Modem (full)"	:
			fota_type == NRF_CLOUD_FOTA_BOOTLOADER	  ?		"Bootloader"	:
										"Invalid");

		/* Notify fota_support of the completed download. */
		on_fota_downloaded();
		break;
	}
	case NRF_CLOUD_EVT_FOTA_ERROR:
		LOG_DBG("NRF_CLOUD_EVT_FOTA_ERROR");
		break;
	default:
		LOG_DBG("Unknown event type: %d", nrf_cloud_evt->type);
		break;
	}
}
#endif /* CONFIG_NRF_CLOUD_MQTT */

/**
 * @brief Set up for the nRF Cloud connection (without connecting)
 *
 * Sets up required event hooks and initializes the nrf_cloud library.
 *
 * @return int - 0 on success, otherwise negative error code.
 */
static int setup_cloud(void)
{
	int err;

	/* Register to be notified of network availability changes.
	 *
	 * If the chosen connectivity layer becomes ready instantaneously, it is possible that
	 * L4_CONNECTED will be fired before reaching this function, in which case we will miss
	 * the notification.
	 *
	 * If that is a serious concern, use SYS_INIT with priority 0 (less than
	 * CONFIG_NET_CONNECTION_MANAGER_PRIORITY) to register this hook before conn_mgr
	 * initializes.
	 *
	 * In reality, connectivity layers such as LTE take some time to go online, so registering
	 * the hook here is fine.
	 */
	net_mgmt_init_event_callback(
		&l4_callback, l4_event_handler, NET_EVENT_L4_CONNECTED | NET_EVENT_L4_DISCONNECTED
	);
	net_mgmt_add_event_callback(&l4_callback);

	/* Register to be notified when the modem has figured out the current time. */
	date_time_register_handler(date_time_event_handler);

#if defined(CONFIG_NRF_CLOUD_MQTT)
	/* Initialize nrf_cloud library. */
	struct nrf_cloud_init_param params = {
		.event_handler = cloud_event_handler,
		.fmfu_dev_inf = get_full_modem_fota_fdev(),
		.application_version = CONFIG_APP_VERSION
	};

	err = nrf_cloud_init(&params);
	if (err) {
		LOG_ERR("nRF Cloud library could not be initialized, error: %d", err);
		return err;
	}

#elif defined(CONFIG_NRF_CLOUD_COAP)
#if defined(CONFIG_NRF_CLOUD_COAP_FOTA)
	err = coap_fota_init();
	if (err) {
		LOG_ERR("Error initializing FOTA: %d", err);
		return err;
	}
	err = coap_fota_begin();
	if (err) {
		LOG_ERR("Error starting FOTA: %d", err);
		return err;
	}
#endif /* CONFIG_NRF_CLOUD_COAP_FOTA */
	err = nrf_cloud_coap_init();
	if (err) {
		LOG_ERR("Failed to initialize CoAP client: %d", err);
		return err;
	}
#endif /* CONFIG_NRF_CLOUD_COAP */

	return 0;
}

void cloud_connection_thread_fn(void)
{
	long_led_pattern(LED_WAITING);

	LOG_INF("Setting up nRF Cloud library...");
	if (setup_cloud()) {
		LOG_ERR("Fatal: nRF Cloud library setup failed");
		long_led_pattern(LED_FAILURE);
		return;
	}

	/* Indefinitely maintain a connection to nRF Cloud whenever the network is reachable. */
	while (true) {
		LOG_INF("Waiting for network ready...");

		if (IS_ENABLED(CONFIG_LED_VERBOSE_INDICATION)) {
			long_led_pattern(LED_WAITING);
		}

		(void)await_network_ready(K_FOREVER);

		LOG_INF("Network is ready");

		/* Attempt to connect to nRF Cloud. */
		if (connect_cloud()) {
			LOG_DBG("Awaiting disconnection from nRF Cloud");

			/* and then wait patiently for a connection problem. */
			(void)await_cloud_disconnected(K_FOREVER);

			LOG_INF("Disconnected from nRF Cloud");
		}

		LOG_INF("Retrying in %d seconds...", CONFIG_CLOUD_CONNECTION_RETRY_TIMEOUT_SECONDS);

		/* Wait a bit before trying again. */
		k_sleep(K_SECONDS(CONFIG_CLOUD_CONNECTION_RETRY_TIMEOUT_SECONDS));
	}
}
```

## src/fota_support.h
```c
/* Copyright (c) 2022 Nordic Semiconductor ASA
 *
 * SPDX-License-Identifier: LicenseRef-Nordic-5-Clause
 */

#ifndef _FOTA_SUPPORT_H_
#define _FOTA_SUPPORT_H_

#include <zephyr/kernel.h>

/**
 * @brief Notify fota_support that a FOTA download has finished.
 *
 * Besides updating the device shadow (handled in connection.c), this is the only additional
 * code needed to get FOTA working properly, and its sole function is to reboot the microcontroller
 * after FOTA download completes.
 *
 */
void fota_reboot(const unsigned int delay_s, const bool error);

/**
 * @brief Get the external flash device used for full modem FOTA updates.
 *
 * This function returns NULL if CONFIG_NRF_CLOUD_FOTA_FULL_MODEM_UPDATE is not
 * enabled.
 *
 */
struct dfu_target_fmfu_fdev * get_full_modem_fota_fdev(void);

#endif /* _FOTA_SUPPORT_H_ */
```
