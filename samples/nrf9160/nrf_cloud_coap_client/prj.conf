## CMakeLists.txt
```
#
# Copyright (c) 2022 Nordic Semiconductor
#
# SPDX-License-Identifier: LicenseRef-Nordic-5-Clause
#

cmake_minimum_required(VERSION 3.20.0)

find_package(Zephyr REQUIRED HINTS $ENV{ZEPHYR_BASE})
project(nrf-cloud-coap-client)
zephyr_compile_definitions(PROJECT_NAME=${PROJECT_NAME})
find_program(ZCBOR zcbor REQUIRED)

# NORDIC SDK APP START
target_sources(app PRIVATE src/main.c)
target_sources_ifdef(CONFIG_WIFI app PRIVATE src/scan_wifi.c)
# NORDIC SDK APP END

zephyr_include_directories(src)
```

## Kconfig
```
#
# Copyright (c) 2022 Nordic Semiconductor ASA
#
# SPDX-License-Identifier: LicenseRef-Nordic-5-Clause
#

menu "nRF Cloud CoAP client sample"

config NRF_CLOUD_COAP_CLIENT_SAMPLE_VERSION
	string "The sample's version string"
	default "1.0.0"

module = NRF_CLOUD_COAP_CLIENT
module-dep = LOG
module-str = nRF Cloud CoAP Client Sample
source "${ZEPHYR_BASE}/subsys/logging/Kconfig.template.log_config"
endmenu # Application sample

menu "Zephyr Kernel"
source "Kconfig.zephyr"
endmenu
```

## sample.yaml
```
sample:
  name: nRF Cloud CoAP client sample
tests:
  samples.nrf9160.nrf_cloud_coap_client:
    build_only: true
    integration_platforms:
      - nrf9160dk_nrf9160_ns
    platform_allow: nrf9160dk_nrf9160_ns nrf9161dk_nrf9161_ns
    tags: ci_build
  sample.nrf9160.nrf_cloud_coap_client.nrf7002ek_wifi:
    build_only: true
    integration_platforms:
      - nrf9160dk_nrf9160_ns
    platform_allow: nrf9160dk_nrf9160_ns nrf9161dk_nrf9161_ns
    extra_args: SHIELD=nrf7002ek OVERLAY_CONFIG=overlay-nrf7002ek-wifi-scan-only.conf
                DTC_OVERLAY_FILE="nrf9160dk_with_nrf7002ek.overlay"
    tags: ci_build
```

## prj.conf
```kconfig
#
# Copyright (c) 2023 Nordic Semiconductor ASA
#
# SPDX-License-Identifier: LicenseRef-Nordic-5-Clause
#
# General config
CONFIG_HEAP_MEM_POOL_SIZE=16384
CONFIG_NEWLIB_LIBC=y
CONFIG_NEWLIB_LIBC_FLOAT_PRINTF=y

CONFIG_DK_LIBRARY=y

# Mbed TLS logs include %zu formatters, which are not handled by the nano
# version of newlib
CONFIG_NEWLIB_LIBC_NANO=n

# Main thread
CONFIG_MAIN_STACK_SIZE=6144
CONFIG_SYSTEM_WORKQUEUE_STACK_SIZE=6144

# Networking
CONFIG_NETWORKING=y
CONFIG_NET_NATIVE=n
CONFIG_NET_OFFLOAD=y
CONFIG_NET_CONFIG_NEED_IPV6=y
CONFIG_NET_IPV4=y
CONFIG_NET_SOCKETS=y
CONFIG_NET_SOCKETS_OFFLOAD=y
CONFIG_NET_SOCKETS_POSIX_NAMES=y

# LTE link control
CONFIG_LTE_LINK_CONTROL=y
CONFIG_LTE_AUTO_INIT_AND_CONNECT=n
CONFIG_LTE_NETWORK_MODE_LTE_M_GPS=y

# Modem library
CONFIG_NRF_MODEM_LIB=y
CONFIG_NRF_MODEM_LIB_LOG_FW_VERSION_UUID=n

# AT Host
CONFIG_UART_INTERRUPT_DRIVEN=y
CONFIG_UART_0_INTERRUPT_DRIVEN=y
CONFIG_AT_HOST_LIBRARY=y
CONFIG_AT_MONITOR_HEAP_SIZE=4096

# LTE link control
CONFIG_NET_L2_VIRTUAL=y

# Date/Time
CONFIG_DATE_TIME=y
CONFIG_DATE_TIME_AUTO_UPDATE=y
CONFIG_DATE_TIME_MODEM=y
CONFIG_DATE_TIME_NTP=n

CONFIG_FPU=y
CONFIG_CBPRINTF_FP_SUPPORT=y

CONFIG_COAP_CLIENT=y
CONFIG_COAP_CLIENT_BLOCK_SIZE=1024
CONFIG_COAP_CLIENT_STACK_SIZE=6144
CONFIG_COAP_CLIENT_THREAD_PRIORITY=0
CONFIG_COAP_EXTENDED_OPTIONS_LEN=y
CONFIG_COAP_EXTENDED_OPTIONS_LEN_VALUE=22

CONFIG_DOWNLOAD_CLIENT_STACK_SIZE=4096

CONFIG_NRF_CLOUD_COAP=y
CONFIG_NRF_CLOUD_REST=y
CONFIG_NRF_CLOUD_AGPS=y

CONFIG_NRF_CLOUD_PGPS=y
CONFIG_NRF_CLOUD_PGPS_REQUEST_UPON_INIT=y
CONFIG_NRF_CLOUD_PGPS_NUM_PREDICTIONS=4

# Flash - Used by FOTA and PGPS
CONFIG_FLASH=y
CONFIG_FLASH_PAGE_LAYOUT=y
CONFIG_FLASH_MAP=y
CONFIG_STREAM_FLASH=y
CONFIG_MPU_ALLOW_FLASH_WRITE=y
CONFIG_PM_EXTERNAL_FLASH_MCUBOOT_SECONDARY=n
CONFIG_FCB=y
CONFIG_SETTINGS=y
CONFIG_SETTINGS_FCB=y

# MCUBOOT - Needed by FOTA
CONFIG_BOOTLOADER_MCUBOOT=y
CONFIG_IMG_MANAGER=y
CONFIG_MCUBOOT_IMG_MANAGER=y
CONFIG_STREAM_FLASH_ERASE=y
CONFIG_IMG_ERASE_PROGRESSIVELY=y

CONFIG_REBOOT=y

# FOTA download
CONFIG_FOTA_DOWNLOAD=y
CONFIG_FOTA_DOWNLOAD_PROGRESS_EVT=y
CONFIG_DFU_TARGET=y
CONFIG_DOWNLOAD_CLIENT=y

CONFIG_LOG=y
CONFIG_NET_LOG=y
CONFIG_LOG_PRINTK=y
CONFIG_COAP_LOG_LEVEL_INF=y
CONFIG_NRF_CLOUD_COAP_LOG_LEVEL_INF=y
CONFIG_NRF_CLOUD_COAP_CLIENT_LOG_LEVEL_INF=y
```

## overlay-debug.conf
```kconfig
#
# Copyright (c) 2022 Nordic Semiconductor ASA
#
# SPDX-License-Identifier: LicenseRef-Nordic-5-Clause
#
# General config
CONFIG_DEBUG=y

# Logging
CONFIG_LOG=y
CONFIG_NRF_CLOUD_COAP_CLIENT_LOG_LEVEL_DBG=y
CONFIG_NRF_CLOUD_COAP_LOG_LEVEL_DBG=y
CONFIG_COAP_LOG_LEVEL_INF=y
CONFIG_LTE_LINK_CONTROL_LOG_LEVEL_WRN=y
CONFIG_NET_LOG=y
CONFIG_NET_OFFLOAD_LOG_LEVEL_WRN=y
CONFIG_NET_UDP_LOG_LEVEL_WRN=y
CONFIG_NET_SOCKETS_LOG_LEVEL_WRN=y
CONFIG_NET_IF_LOG_LEVEL_WRN=y
CONFIG_NET_CONFIG_LOG_LEVEL_WRN=y
CONFIG_DNS_RESOLVER_LOG_LEVEL_WRN=n
CONFIG_NET_CONTEXT_LOG_LEVEL_WRN=y
CONFIG_AT_HOST_LOG_LEVEL_WRN=y
CONFIG_DATE_TIME_LOG_LEVEL_INF=y
CONFIG_SETTINGS_LOG_LEVEL_INF=y
CONFIG_DOWNLOAD_CLIENT_LOG_LEVEL_INF=y

CONFIG_LOG_PRINTK=y
CONFIG_LOG_MODE_IMMEDIATE=y
CONFIG_LOG_DEFAULT_LEVEL=3
CONFIG_LOG_FUNC_NAME_PREFIX_DBG=y
CONFIG_LOG_FUNC_NAME_PREFIX_INF=y
CONFIG_LOG_FUNC_NAME_PREFIX_WRN=y
CONFIG_LOG_FUNC_NAME_PREFIX_ERR=y

# Modem library
CONFIG_NRF_MODEM_LIB_TRACE=y
CONFIG_NRF_MODEM_LIB_LOG_LEVEL_INF=y

CONFIG_NRF_MODEM_LOG=n
CONFIG_NRF_CLOUD_LOG_LEVEL_INF=y
CONFIG_NRF_CLOUD_GPS_LOG_LEVEL_INF=y
```

## overlay-nrf-mbedtls.conf
```kconfig
#
# Copyright (c) 2022 Nordic Semiconductor ASA
#
# SPDX-License-Identifier: LicenseRef-Nordic-5-Clause
#

#CONFIG_SPM=n

# General config
CONFIG_COAP_DTLS=y

# MbedTLS needs a larger stack for the system workqueue
CONFIG_SYSTEM_WORKQUEUE_STACK_SIZE=3072
# MbedTLS needs a larger heap
CONFIG_HEAP_MEM_POOL_SIZE=8192

# Networking
CONFIG_NET_SOCKETS_SOCKOPT_TLS=y
CONFIG_NET_SOCKETS_TLS_MAX_CONTEXTS=4
CONFIG_NET_SOCKETS_TLS_SET_MAX_FRAGMENT_LENGTH=y
CONFIG_NET_SOCKETS_ENABLE_DTLS=y

# Configure for offloaded UDP and non-offloaded TLS
CONFIG_NET_SOCKETS_OFFLOAD_PRIORITY=50
CONFIG_MODEM_KEY_MGMT=n
CONFIG_NET_NATIVE=y

# Modem info
CONFIG_MODEM_INFO=y
CONFIG_MODEM_INFO_ADD_DEVICE=y
CONFIG_MODEM_INFO_ADD_NETWORK=y
CONFIG_MODEM_INFO_ADD_DATE_TIME=n
CONFIG_MODEM_INFO_ADD_SIM=n
CONFIG_MODEM_INFO_ADD_SIM_ICCID=n
CONFIG_MODEM_INFO_ADD_SIM_IMSI=n
#CONFIG_MODEM_INFO_ADD_BOARD=n

# AT Host
#CONFIG_UART_INTERRUPT_DRIVEN=y

# Select mbed TLS
CONFIG_MBEDTLS=y
CONFIG_MBEDTLS_TLS_VERSION_1_2=y

CONFIG_MBEDTLS_LIBRARY_NRF_SECURITY=y
CONFIG_NRF_SECURITY_ADVANCED=y
CONFIG_NORDIC_SECURITY_BACKEND=y
CONFIG_MBEDTLS_ECDSA_C=n
CONFIG_MBEDTLS_ECDH_C=n

# TFM configuration
CONFIG_BUILD_WITH_TFM=n
CONFIG_SPM=y
#CONFIG_BOOTLOADER_MCUBOOT=y
#CONFIG_TFM_MCUBOOT_IMAGE_NUMBER=1
# Currently IPC isn't supported with NCS mcuboot
#CONFIG_TFM_IPC=y
#CONFIG_TFM_BL2=n
#CONFIG_ENTROPY_CC3XX=y

# MbedTLS changes
CONFIG_MBEDTLS_ENABLE_HEAP=y
CONFIG_MBEDTLS_HEAP_SIZE=16384
CONFIG_MBEDTLS_SSL_IN_CONTENT_LEN=2048
CONFIG_MBEDTLS_SSL_OUT_CONTENT_LEN=2048


CONFIG_MBEDTLS_TLS_LIBRARY=y
CONFIG_MBEDTLS_X509_LIBRARY=y
CONFIG_MBEDTLS_PSA_CRYPTO_C=y
CONFIG_MBEDTLS_SHA1_C=y

# Customize the set of ciphers enabled to only that which is needed
#CONFIG_MBEDTLS_CIPHER_CCM_ENABLED=y
CONFIG_MBEDTLS_CIPHER_ALL_ENABLED=n
#CONFIG_MBEDTLS_CIPHER_AES_ENABLED=y
CONFIG_MBEDTLS_CIPHER_DES_ENABLED=n
CONFIG_MBEDTLS_MAC_ALL_ENABLED=n
CONFIG_MBEDTLS_ECP_ALL_ENABLED=n
CONFIG_MBEDTLS_KEY_EXCHANGE_ALL_ENABLED=n
CONFIG_MBEDTLS_KEY_EXCHANGE_RSA_ENABLED=n
CONFIG_MBEDTLS_KEY_EXCHANGE_PSK_ENABLED=y
CONFIG_MBEDTLS_KEY_EXCHANGE_ECDH_ECDSA_ENABLED=n
CONFIG_MBEDTLS_KEY_EXCHANGE_ECDH_RSA_ENABLED=n
CONFIG_MBEDTLS_KEY_EXCHANGE_DHE_RSA_ENABLED=n
CONFIG_MBEDTLS_KEY_EXCHANGE_ECDHE_RSA_ENABLED=n
CONFIG_MBEDTLS_KEY_EXCHANGE_ECDHE_ECDSA_ENABLED=n
CONFIG_MBEDTLS_KEY_EXCHANGE_RSA_PSK_ENABLED=n
CONFIG_MBEDTLS_PK_PARSE_C=y

# DTLS-specific settings
CONFIG_MBEDTLS_DTLS=y
CONFIG_MBEDTLS_SSL_DTLS_CONNECTION_ID=y
CONFIG_MBEDTLS_SSL_EXTENDED_MASTER_SECRET=y
CONFIG_MBEDTLS_SSL_SERVER_NAME_INDICATION=y

CONFIG_TLS_CREDENTIALS=y

# CoAP
CONFIG_COAP_EXTENDED_OPTIONS_LEN=y
# configure the following to a CoAP server to which your PSK has already
# been provisioned (if using DTLS):
#CONFIG_COAP_SERVER_HOSTNAME=""

# Logging
CONFIG_MBEDTLS_DEBUG_C=y
CONFIG_MBEDTLS_DEBUG_LEVEL=1
#CONFIG_MBEDTLS_SSL_DEBUG_ALL=y
```

## overlay-offload-tls.conf
```kconfig
#
# Copyright (c) 2022 Nordic Semiconductor ASA
#
# SPDX-License-Identifier: LicenseRef-Nordic-5-Clause
#
# General config
CONFIG_NRF_CLOUD_COAP_DTLS=y
CONFIG_NRF_CLOUD_COAP_DTLS_CID=y

# Networking
CONFIG_NET_SOCKETS_TLS_SET_MAX_FRAGMENT_LENGTH=y

# Configure for using offloaded UDP and TLS
CONFIG_NET_SOCKETS_OFFLOAD_PRIORITY=40
CONFIG_MODEM_KEY_MGMT=y

# Modem info
CONFIG_MODEM_INFO=y
CONFIG_MODEM_INFO_ADD_DEVICE=y
CONFIG_MODEM_INFO_ADD_NETWORK=y
CONFIG_MODEM_INFO_ADD_DATE_TIME=y
CONFIG_MODEM_INFO_ADD_SIM=y
CONFIG_MODEM_INFO_ADD_SIM_ICCID=y
CONFIG_MODEM_INFO_ADD_SIM_IMSI=n

# CoAP
CONFIG_COAP_EXTENDED_OPTIONS_LEN=y

# these need to match in offloaded mode
#CONFIG_NRF_CLOUD_COAP_SEC_TAG=16842753
#CONFIG_NRF_CLOUD_SEC_TAG=16842753
CONFIG_NRF_CLOUD_COAP_SEC_TAG=86
CONFIG_NRF_CLOUD_SEC_TAG=86
CONFIG_MODEM_JWT=y
```

## src/main.c
```c
/*
 * Copyright (c) 2022 Nordic Semiconductor ASA
 *
 * SPDX-License-Identifier: LicenseRef-Nordic-5-Clause
 */

#include <stdio.h>
#include <string.h>

#include <zephyr/kernel.h>
#include <zephyr/net/coap.h>
#include <zephyr/net/socket.h>
#include <modem/lte_lc.h>
#include <modem/modem_info.h>
#include <modem/nrf_modem_lib.h>
#include <zephyr/random/rand32.h>
#if defined(CONFIG_LWM2M_CARRIER)
#include <lwm2m_carrier.h>
#endif
#include <nrf_socket.h>
#include <nrf_modem_at.h>
#include <date_time.h>
#include <net/nrf_cloud.h>
#include <net/nrf_cloud_coap.h>
#include <version.h>
#include "scan_wifi.h"
#include "handle_fota.h"

#include <zephyr/logging/log.h>
LOG_MODULE_REGISTER(nrf_cloud_coap_client, CONFIG_NRF_CLOUD_COAP_CLIENT_LOG_LEVEL);

#define CREDS_REQ_WAIT_SEC 10
#define APP_WAIT_CELLS_S 30
#define BTN_NUM 1
#define APP_COAP_SEND_INTERVAL_MS 20000
#define APP_COAP_INTERVAL_LIMIT 60

/* Uncomment to incrementally increase time between coap packets */
/* #define DELAY_INTERPACKET_PERIOD */

/* Modem FW version required to properly run this sample */
#define MFWV_MAJ_SAMPLE_REQ	1
#define MFWV_MIN_SAMPLE_REQ	3
#define MFWV_REV_SAMPLE_REQ	0
/* Modem FW version required for extended neighbor cells search */
#define MFWV_MAJ_EXT_SRCH	1
#define MFWV_MIN_EXT_SRCH	3
#define MFWV_REV_EXT_SRCH	1
/* Modem FW version required for extended GCI neighbor cells search */
#define MFWV_MAJ_EXT_SRCH_GCI	1
#define MFWV_MIN_EXT_SRCH_GCI	3
#define MFWV_REV_EXT_SRCH_GCI	4

/* Type of data to be sent in the cellular positioning request */
enum nrf_cloud_location_type active_cell_pos_type = LOCATION_TYPE_SINGLE_CELL;

static bool authorized;

/* Search type used for neighbor cell measurements; modem FW version depenedent */
static enum lte_lc_neighbor_search_type search_type =
						  LTE_LC_NEIGHBOR_SEARCH_TYPE_GCI_EXTENDED_COMPLETE;

/* Buffer to hold neighbor cell measurement data for multi-cell requests */
static struct lte_lc_ncell neighbor_cells[CONFIG_LTE_NEIGHBOR_CELLS_MAX];

/* Buffer to hold GCI cell measurement data for multi-cell requests */
static struct lte_lc_cell gci_cells[5];

/* Modem info struct used for modem FW version and cell info used for single-cell requests */
static struct modem_param_info mdm_param;

/* Structure to hold all cell info */
static struct lte_lc_cells_info cell_info;

/* Current RRC mode */
static enum lte_lc_rrc_mode cur_rrc_mode = LTE_LC_RRC_MODE_IDLE;

/* Flag to indicate that a neighbor cell measurement should be taken once RRC mode is idle */
static bool request_cells = true;

static bool pgps_active;

static uint8_t agps_buf[4096];

/* Semaphore to indicate that cell info has been received */
static K_SEM_DEFINE(cell_info_ready_sem, 0, 1);

/* Mutex for cell info struct */
static K_MUTEX_DEFINE(cell_info_mutex);

#if defined(CONFIG_WIFI)
/* Semaphore to indicate Wi-Fi scanning is complete */
static K_SEM_DEFINE(wifi_scan_sem, 0, 1);
#endif

static void get_cell_info(void);
static int do_pgps(struct gps_pgps_request *pgps_req);
static int update_shadow(void);

static bool ver_check(int32_t reqd_maj, int32_t reqd_min, int32_t reqd_rev,
		      int32_t maj, int32_t min, int32_t rev)
{
	if (maj > reqd_maj) {
		return true;
	} else if ((maj == reqd_maj) && (min > reqd_min)) {
		return true;
	} else if ((maj == reqd_maj) && (min == reqd_min) && (rev >= reqd_rev)) {
		return true;
	}
	return false;
}

static void check_modem_fw_version(void)
{
	char mfwv_str[128];
	uint32_t major;
	uint32_t minor;
	uint32_t rev;

	if (modem_info_string_get(MODEM_INFO_FW_VERSION, mfwv_str, sizeof(mfwv_str)) <= 0) {
		LOG_WRN("Failed to get modem FW version");
		return;
	}

	LOG_INF("Modem FW version: %s", mfwv_str);

	if (sscanf(mfwv_str, "mfw_nrf9160_%u.%u.%u", &major, &minor, &rev) != 3) {
		LOG_WRN("Unable to parse modem FW version number");
		return;
	}

	/* Ensure the modem firmware version meets the requirement for this sample */
	if (!ver_check(MFWV_MAJ_SAMPLE_REQ, MFWV_MIN_SAMPLE_REQ, MFWV_REV_SAMPLE_REQ,
		       major, minor, rev)) {
		LOG_ERR("This sample requires modem FW version %d.%d.%d or later",
			MFWV_MAJ_SAMPLE_REQ, MFWV_MIN_SAMPLE_REQ, MFWV_REV_SAMPLE_REQ);
		LOG_INF("Update modem firmware and restart");
		k_sleep(K_FOREVER);
	}

	/* Enable GCI/extended search if modem fw version allows */
	if (ver_check(MFWV_MAJ_EXT_SRCH_GCI, MFWV_MIN_EXT_SRCH_GCI, MFWV_REV_EXT_SRCH_GCI,
		      major, minor, rev)) {
		search_type = LTE_LC_NEIGHBOR_SEARCH_TYPE_GCI_EXTENDED_COMPLETE;
		LOG_INF("Using LTE LC neighbor search type GCI extended complete for %d cells",
			ARRAY_SIZE(gci_cells));
	} else if (ver_check(MFWV_MAJ_EXT_SRCH, MFWV_MIN_EXT_SRCH, MFWV_REV_EXT_SRCH,
			     major, minor, rev)) {
		search_type = LTE_LC_NEIGHBOR_SEARCH_TYPE_EXTENDED_COMPLETE;
		LOG_INF("Using LTE LC neighbor search type extended complete");
	} else {
		LOG_INF("Using LTE LC neighbor search type default");
	}
}

#if defined(CONFIG_NRF_MODEM_LIB)
/**@brief Recoverable modem library error. */
void nrf_modem_recoverable_error_handler(uint32_t err)
{
	LOG_ERR("Modem library recoverable error: %u", (unsigned int)err);
}
#endif /* defined(CONFIG_NRF_MODEM_LIB) */

#if defined(CONFIG_LWM2M_CARRIER)
K_SEM_DEFINE(carrier_registered, 0, 1);

void lwm2m_carrier_event_handler(const lwm2m_carrier_event_t *event)
{
	switch (event->type) {
	case LWM2M_CARRIER_EVENT_BSDLIB_INIT:
		LOG_INF("LWM2M_CARRIER_EVENT_BSDLIB_INIT");
		break;
	case LWM2M_CARRIER_EVENT_CONNECT:
		LOG_INF("LWM2M_CARRIER_EVENT_CONNECT");
		break;
	case LWM2M_CARRIER_EVENT_DISCONNECT:
		LOG_INF("LWM2M_CARRIER_EVENT_DISCONNECT");
		break;
	case LWM2M_CARRIER_EVENT_READY:
		LOG_INF("LWM2M_CARRIER_EVENT_READY");
		k_sem_give(&carrier_registered);
		break;
	case LWM2M_CARRIER_EVENT_FOTA_START:
		LOG_INF("LWM2M_CARRIER_EVENT_FOTA_START");
		break;
	case LWM2M_CARRIER_EVENT_REBOOT:
		LOG_INF("LWM2M_CARRIER_EVENT_REBOOT");
		break;
	}
}
#endif /* defined(CONFIG_LWM2M_CARRIER) */

K_SEM_DEFINE(lte_ready, 0, 1);

static void lte_handler(const struct lte_lc_evt *const evt)
{
	switch (evt->type) {
	case LTE_LC_EVT_NW_REG_STATUS:
		if ((evt->nw_reg_status == LTE_LC_NW_REG_REGISTERED_HOME) ||
		    (evt->nw_reg_status == LTE_LC_NW_REG_REGISTERED_ROAMING)) {
			LOG_DBG("Connected to LTE network");
			k_sem_give(&lte_ready);
		} else {
			LOG_DBG("reg status %d", evt->nw_reg_status);
		}
		break;

	case LTE_LC_EVT_CELL_UPDATE:
		if (evt->cell.id == LTE_LC_CELL_EUTRAN_ID_INVALID) {
			break;
		}

		/* Get new info when cell ID changes */
		LOG_DBG("Cell info changed");
		request_cells = true;
		get_cell_info();
		break;
	case LTE_LC_EVT_RRC_UPDATE:
		cur_rrc_mode = evt->rrc_mode;
		if (cur_rrc_mode == LTE_LC_RRC_MODE_IDLE) {
			LOG_DBG("RRC mode: idle");
		} else {
			LOG_DBG("RRC mode: connected");
		}
		if (request_cells && (cur_rrc_mode == LTE_LC_RRC_MODE_IDLE)) {
			get_cell_info();
		}
		break;
	case LTE_LC_EVT_NEIGHBOR_CELL_MEAS:
		if ((search_type < LTE_LC_NEIGHBOR_SEARCH_TYPE_GCI_DEFAULT) &&
		    (evt->cells_info.current_cell.id == LTE_LC_CELL_EUTRAN_ID_INVALID)) {
			LOG_WRN("Current cell ID not valid in neighbor cell measurement results");
			break;
		}

		(void)k_mutex_lock(&cell_info_mutex, K_FOREVER);
		/* Copy current cell information. */
		memcpy(&cell_info.current_cell,
		       &evt->cells_info.current_cell,
		       sizeof(cell_info.current_cell));

		/* Copy neighbor cell information if present. */
		cell_info.ncells_count = evt->cells_info.ncells_count;
		if ((evt->cells_info.ncells_count > 0) && (evt->cells_info.neighbor_cells)) {
			memcpy(neighbor_cells,
			       evt->cells_info.neighbor_cells,
			       sizeof(neighbor_cells[0]) * cell_info.ncells_count);
			LOG_DBG("Received measurements for %u neighbor cells",
				cell_info.ncells_count);
		} else {
			LOG_DBG("No neighbor cells were measured");
		}

		/* Copy GCI cell information if present. */
		cell_info.gci_cells_count = evt->cells_info.gci_cells_count;
		if ((evt->cells_info.gci_cells_count > 0) && (evt->cells_info.gci_cells)) {
			memcpy(gci_cells,
			       evt->cells_info.gci_cells,
			       sizeof(gci_cells[0]) * cell_info.gci_cells_count);
			LOG_DBG("Received measurements for %u GCI cells",
				cell_info.gci_cells_count);
		} else if (search_type == LTE_LC_NEIGHBOR_SEARCH_TYPE_GCI_EXTENDED_COMPLETE) {
			LOG_DBG("No GCI cells were measured");
		}

		(void)k_mutex_unlock(&cell_info_mutex);
		k_sem_give(&cell_info_ready_sem);

		break;
	default:
		LOG_DBG("LTE event %d (0x%x)", evt->type, evt->type);
		break;
	}
}

void pgps_handler(struct nrf_cloud_pgps_event *event)
{
	switch (event->type) {
	case PGPS_EVT_INIT:
		LOG_INF("PGPS_EVT_INIT");
		break;
	case PGPS_EVT_UNAVAILABLE:
		LOG_INF("PGPS_EVT_UNAVAILABLE");
		break;
	case PGPS_EVT_LOADING:
		LOG_INF("PGPS_EVT_LOADING");
		break;
	case PGPS_EVT_AVAILABLE:
		LOG_INF("PGPS_EVT_AVAILABLE");
		break;
	case PGPS_EVT_READY:
		LOG_INF("PGPS_EVT_READY");
		pgps_active = false;
		break;
	case PGPS_EVT_REQUEST:
		LOG_INF("PGPS_EVT_REQUEST");
		pgps_active = true;
		do_pgps(event->request);
		break;
	}
}

/**@brief Configures modem to provide LTE link. Blocks until link is
 * successfully established.
 */
static void modem_configure(void)
{
	int err;

	err = nrf_modem_lib_init();
	if (err < 0) {
		LOG_ERR("Modem library initialization failed, error: %d", err);
		return;
	} else if (err > 0) {
		LOG_INF("Modem firmware update in progress: 0x%X", err);
		return;
	}

	lte_lc_register_handler(lte_handler);
#if defined(CONFIG_LTE_LINK_CONTROL)
#if defined(CONFIG_LWM2M_CARRIER)
	/* Wait for the LWM2M_CARRIER to configure the modem and
	 * start the connection.
	 */
	LOG_INF("Waiting for carrier registration...");
	k_sem_take(&carrier_registered, K_FOREVER);
	LOG_INF("Registered");
#else /* defined(CONFIG_LWM2M_CARRIER) */
	LOG_INF("LTE Link Connecting ...");
	err = lte_lc_init_and_connect();
	__ASSERT(err == 0, "LTE link could not be established.");
	k_sem_take(&lte_ready, K_FOREVER);
	LOG_INF("LTE Link Connected");
	err = lte_lc_psm_req(true);
	if (err) {
		LOG_ERR("Unable to enter PSM mode: %d", err);
	}

	err = nrf_modem_at_printf("AT+CEREG=5");
	if (err) {
		LOG_ERR("Can't subscribe to +CEREG events.");
	}

#endif /* defined(CONFIG_LWM2M_CARRIER) */
#endif /* defined(CONFIG_LTE_LINK_CONTROL) */
	/* Modem info library is used to obtain the modem FW version
	 * and network info for single-cell requests
	 */
	err = modem_info_init();
	if (err) {
		LOG_ERR("Modem info initialization failed, error: %d", err);
		return;
	}

	err = modem_info_params_init(&mdm_param);
	if (err) {
		LOG_ERR("Modem info params initialization failed, error: %d", err);
		return;
	}

	err = modem_info_params_get(&mdm_param);
	if (err) {
		LOG_ERR("Modem info params reading failed, error: %d", err);
	}

	/* Check modem FW version */
	check_modem_fw_version();
}

int init(void)
{
	int err;

	err = handle_fota_init();
	if (err) {
		LOG_ERR("Error initializing FOTA: %d", err);
	}

	modem_configure();

	err = handle_fota_begin();
	if (err) {
		return err;
	}

#if defined(CONFIG_WIFI)
	err = scan_wifi_init();
	if (err) {
		LOG_ERR("Error initializing Wi-Fi scanning: %d", err);
		return err;
	}
#endif

	err = nrf_cloud_coap_init();
	if (err) {
		LOG_ERR("Failed to initialize CoAP client: %d", err);
		return err;
	}

	err = nrf_cloud_coap_connect();
	if (err) {
		LOG_ERR("Failed to connect and get authorized: %d", err);
		return err;
	}
	authorized = nrf_cloud_coap_is_authorized();
	if (authorized) {
		get_cell_info();
	} else {
		LOG_ERR("Device is not authorized to use nRF Cloud CoAP services");
		return -EACCES;
	}

	err = update_shadow();
	if (err) {
		LOG_ERR("Error updating shadow");
		return err;
	} else {
		LOG_INF("Shadow updated");
	}

	struct nrf_cloud_pgps_init_param param = {
		.event_handler = pgps_handler,
		.storage_base = 0,
		.storage_size = 0
	};

	err = nrf_cloud_pgps_init(&param);
	if (err) {
		LOG_ERR("Failed to initialize P-GPS: %d", err);
	}

	return err;
}

static void get_cell_info(void)
{
	int err;

	if (!authorized || !request_cells) {
		return;
	}

	struct lte_lc_ncellmeas_params ncellmeas_params = {
		.search_type = search_type,
		.gci_count = ARRAY_SIZE(gci_cells)
	};

	/* Set the result buffers */
	cell_info.neighbor_cells = neighbor_cells;
	cell_info.gci_cells = gci_cells;

	LOG_INF("Requesting neighbor cell measurement");
	err = lte_lc_neighbor_cell_measurement(&ncellmeas_params);
	if (err) {
		LOG_ERR("Failed to start neighbor cell measurement, error: %d", err);
	} else {
		request_cells = false;
		LOG_INF("Waiting for measurement results...");
	}
}

static int do_pgps(struct gps_pgps_request *pgps_req)
{
	int err;
	struct nrf_cloud_rest_pgps_request pgps_request;
	struct nrf_cloud_pgps_result pgps_res;
	static char host[64];
	static char path[128];

	LOG_INF("******** Getting P-GPS data");
	memset(&pgps_request, 0, sizeof(pgps_request));
	memset(&pgps_res, 0, sizeof(pgps_res));
	pgps_request.pgps_req = pgps_req;
	LOG_INF("period_min:%u, pred_cnt:%u, gps_day:%u, gps_time:%u",
		pgps_req->prediction_period_min, pgps_req->prediction_count,
		pgps_req->gps_day, pgps_req->gps_time_of_day);
	memset(host, 0, sizeof(host));
	memset(path, 0, sizeof(path));
	pgps_res.host = host;
	pgps_res.host_sz = sizeof(host);
	pgps_res.path = path;
	pgps_res.path_sz = sizeof(path);
	err = nrf_cloud_coap_pgps_data_get(&pgps_request, &pgps_res);
	if (err) {
		LOG_ERR("Failed to request P-GPS: %d", err);
		return err;
	}
	LOG_INF("P-GPS host:%s, host_sz:%u, path:%s, path_sz:%u",
		pgps_res.host, pgps_res.host_sz, pgps_res.path, pgps_res.path_sz);
	err = nrf_cloud_pgps_update(&pgps_res);
	if (err) {
		nrf_cloud_pgps_request_reset();
		LOG_ERR("P-GPS data processing failed, error: %d", err);
		return err;
	}

	LOG_DBG("P-GPS data processed");
	err = nrf_cloud_pgps_notify_prediction();
	if (err) {
		LOG_ERR("GNSS: Failed to request current prediction, error: %d", err);
	} else {
		LOG_DBG("P-GPS prediction requested");
	}
	return err;
}

static int update_shadow(void)
{
	/* Enable FOTA for bootloader, modem and application */
	struct nrf_cloud_svc_info_fota fota = {
		.modem = 1,
		.application = 1
	};
	struct nrf_cloud_svc_info_ui ui_info = {
		.gnss = true,
		.temperature = true
	};
	struct nrf_cloud_svc_info service_info = {
		.fota = &fota,
		.ui = &ui_info
	};
	struct nrf_cloud_modem_info modem_info = {
		.device = NRF_CLOUD_INFO_SET,
		.network = NRF_CLOUD_INFO_SET,
		.sim = IS_ENABLED(CONFIG_MODEM_INFO_ADD_SIM) ? NRF_CLOUD_INFO_SET : 0,
		/* Use the modem info already obtained */
		.mpi = &mdm_param,
		/* Include the application version */
		.application_version = CONFIG_NRF_CLOUD_COAP_CLIENT_SAMPLE_VERSION
	};
	struct nrf_cloud_device_status device_status = {
		.modem = &modem_info,
		.svc = &service_info
	};

	return nrf_cloud_coap_shadow_device_status_update(&device_status);
}

static int do_next_test(void)
{
	static double temp = 21.5;
	static int cur_test = 1;
	static struct nrf_cloud_gnss_data gnss;
	static bool got_agps = false;
	static const char *location_types[] = {
		"SINGLE_CELL",
		"MULTI_CELL",
		"WIFI"
	};
	int err = 0;
	struct nrf_cloud_rest_location_request loc_request;
	struct nrf_cloud_location_result result;
	struct nrf_cloud_rest_agps_request agps_request;
	struct nrf_modem_gnss_agps_data_frame agps_req;
	struct nrf_cloud_rest_agps_result agps_res;
	struct wifi_scan_info *wifi_info = NULL;
	char buf[512];

	if (!gnss.type) {
		gnss.type = NRF_CLOUD_GNSS_TYPE_PVT;
		gnss.pvt.lat = 45.525616;
		gnss.pvt.lon = -122.685978;
		gnss.pvt.accuracy = 30;
	}

	printk("\n***********************************************\n");
	switch (cur_test) {
	case 1:
		printk("**** %d. Getting pending FOTA job execution ****\n", cur_test);
		err = handle_fota_process();
		if (err != -EAGAIN) {
			LOG_INF("FOTA check completed.");
		}
		break;
	case 2:
		printk("*** %d. Sending temperature ********************\n", cur_test);
		err = nrf_cloud_coap_sensor_send(NRF_CLOUD_JSON_APPID_VAL_TEMP, temp);
		if (err) {
			LOG_ERR("Error sending sensor data: %d", err);
			break;
		} else {
			LOG_INF("Sent %.1f C", temp);
		}
		temp += 0.1;
		break;
	case 3:
		printk("*** %d. Getting position ***********************\n", cur_test);
		LOG_INF("Waiting for neighbor cells..");
		err = k_sem_take(&cell_info_ready_sem, K_SECONDS(APP_WAIT_CELLS_S));
		if (err) {
			LOG_ERR("Timeout waiting for cells: %d", err);
			break;
		}
#if defined(CONFIG_WIFI)
		err = scan_wifi_start(&wifi_scan_sem);
		LOG_INF("Waiting for Wi-Fi scans...");
		k_sem_take(&wifi_scan_sem, K_FOREVER);
		if (err) {
			LOG_ERR("Error starting Wi-Fi scan: %d", err);
			break;
		}
		wifi_info = scan_wifi_results_get();
#endif

		(void)k_mutex_lock(&cell_info_mutex, K_FOREVER);

		if (cell_info.current_cell.id != LTE_LC_CELL_EUTRAN_ID_INVALID) {
			LOG_INF("Current cell info: Cell ID: %u, TAC: %u, MCC: %d, MNC: %d",
				cell_info.current_cell.id, cell_info.current_cell.tac,
				cell_info.current_cell.mcc, cell_info.current_cell.mnc);
		} else {
			LOG_WRN("No current serving cell available");
		}

		if (cell_info.ncells_count || cell_info.gci_cells_count) {
			LOG_INF("Performing multi-cell request with "
				"%u neighbor cells and %u GCI cells",
				cell_info.ncells_count, cell_info.gci_cells_count);
		} else {
			LOG_INF("Performing single-cell request");
		}

		loc_request.cell_info = &cell_info;
		loc_request.wifi_info = wifi_info;
		err = nrf_cloud_coap_location_get(&loc_request, &result);
		(void)k_mutex_unlock(&cell_info_mutex);
		if (err) {
			LOG_ERR("Unable to get location: %d", err);
			break;
		} else {
			const char *type;

			if ((result.type >= 0) && (result.type < LOCATION_TYPE__INVALID)) {
				type = location_types[result.type];
			} else {
				type = "unknown";
			}
			/* Process the returned location once it arrives */
			gnss.pvt.lat = result.lat;
			gnss.pvt.lon = result.lon;
			gnss.pvt.accuracy = result.unc;
			LOG_INF("Location: %s, %.12g, %.12g, %d", type,
				result.lat, result.lon, result.unc);
		}
		request_cells = true;
		break;
	case 4:
		printk("*** %d. Sending GNSS PVT ***********************\n", cur_test);
		err = nrf_cloud_coap_location_send(&gnss);
		if (err) {
			LOG_ERR("Error sending GNSS PVT data: %d", err);
			break;
		} else {
			LOG_INF("PVT sent");
		}
		break;
	case 5:
		printk("*** %d. Getting A-GPS data *********************\n", cur_test);
		if (got_agps) {
			LOG_INF("Not required yet.");
			break;
		}
		memset(&agps_request, 0, sizeof(agps_request));
		memset(&agps_req, 0, sizeof(agps_req));
		agps_request.type = NRF_CLOUD_REST_AGPS_REQ_ASSISTANCE;
		agps_request.net_info = &cell_info;
		agps_request.agps_req = &agps_req;
		agps_req.data_flags = 0x3f;
		agps_req.sv_mask_alm = 0xffffffff;
		agps_req.sv_mask_ephe = 0xffffffff;
		agps_res.buf = agps_buf;
		agps_res.buf_sz = sizeof(agps_buf);
		err = nrf_cloud_coap_agps_data_get(&agps_request, &agps_res);
		if (err) {
			LOG_ERR("Failed to request A-GPS: %d", err);
		} else {
			LOG_INF("Processing %u bytes of A-GPS data", agps_res.agps_sz);
			err = nrf_cloud_agps_process(agps_res.buf, agps_res.agps_sz);
			if (err) {
				LOG_ERR("A-GPS data processing failed, error: %d", err);
			}  else {
				LOG_INF("A-GPS data processed");
				got_agps = true;
			}
		}
		break;
	case 6:
		printk("*** %d. Getting shadow delta *******************\n", cur_test);
		buf[0] = '\0';
		err = nrf_cloud_coap_shadow_get(buf, sizeof(buf) - 1, true);
		if (err) {
			LOG_ERR("Failed to request shadow delta: %d", err);
		} else {
			size_t len = strlen(buf);

			LOG_INF("Delta: %s", len ? buf : "None");
			if (len) {
				err = nrf_cloud_coap_shadow_state_update(buf);
				if (err) {
					LOG_ERR("Failed to acknowledge delta: %d", err);
				} else {
					LOG_INF("Delta acknowledged");
				}
			}
		}
		break;
	}

	if (++cur_test > 6) {
		cur_test = 1;
	}
	return err;
}

int main(void)
{
	int64_t next_msg_time;
	int delta_ms = APP_COAP_SEND_INTERVAL_MS;
	int err;
	int i = 1;
	bool reconnect = false;

	LOG_INF("\n");
	LOG_INF("The nRF Cloud CoAP client sample started\n");

	err = init();
	if (err) {
		LOG_ERR("Halting.");
		for (;;) {
		}
	}
	next_msg_time = k_uptime_get() + delta_ms;

	while (1) {
		if (authorized && !pgps_active && (k_uptime_get() >= next_msg_time)) {
			if (reconnect) {
				reconnect = false;
				authorized = false;
				LOG_INF("Going online");
				err = lte_lc_normal();
				if (err) {
					LOG_ERR("Error going online: %d", err);
				} else {
					k_sem_take(&lte_ready, K_FOREVER);
					err = nrf_cloud_coap_init();
					if (err) {
						LOG_ERR("Failed to initialize CoAP client");
						break;
					}
					err = nrf_cloud_coap_connect();
					if (err) {
						LOG_ERR("Failed to connect and get authorized: %d",
							err);
						break;
					}
					authorized = nrf_cloud_coap_is_authorized();
					if (authorized) {
						get_cell_info();
					}
				}
			}

			err = do_next_test();
			if (err == -EAGAIN) {
				reconnect = true;
				err = nrf_cloud_coap_close();
				if (err) {
					LOG_ERR("Error closing socket: %d", err);
				} else {
					LOG_INF("Socket closed.");
				}
				LOG_INF("Going offline");
				err = lte_lc_offline();
				if (err) {
					LOG_ERR("Error going offline: %d", err);
				} else {
					LOG_INF("Offline.");
				}
				continue;
			}

			delta_ms = APP_COAP_SEND_INTERVAL_MS * i;
			next_msg_time += delta_ms;
#if defined(DELAY_INTERPACKET_PERIOD)
			LOG_INF("Next transfer in %d minutes, %d seconds",
				delta_ms / 60000, (delta_ms / 1000) % 60);
			if (++i > APP_COAP_INTERVAL_LIMIT) {
				i = APP_COAP_INTERVAL_LIMIT;
			}
#endif
		} else if (!authorized) {
			authorized = nrf_cloud_coap_is_authorized();
			if (authorized) {
				get_cell_info();
			}
		}
		k_sleep(K_MSEC(100));
	}
	nrf_cloud_coap_close();
	return err;
}
```

## src/app_jwt.c
```c
#include <stdio.h>
#include <string.h>

#include <zephyr/kernel.h>
#include <modem/modem_jwt.h>
#include <nrf_modem_at.h>
#include <date_time.h>
#include <net/nrf_cloud.h>
#include <psa/crypto.h>
#include <psa/crypto_extra.h>
#ifdef CONFIG_BUILD_WITH_TFM
#include <tfm_ns_interface.h>
#endif
#include <zephyr/sys/base64.h>
#include <cJSON.h>
#include "cJSON_os.h"

#include "app_jwt.h"

#include <zephyr/logging/log.h>
LOG_MODULE_DECLARE(app_jwt, CONFIG_NRF_CLOUD_COAP_CLIENT_LOG_LEVEL);

#define JWT_BUF_SZ	900

#if 0
static psa_key_handle_t keypair_handle;
static psa_key_handle_t pub_key_handle;
#endif

int app_jwt_init(void)
{
	cJSON_Init();

	psa_status_t status;

	/* Initialize PSA Crypto */
	status = psa_crypto_init();
	if (status != PSA_SUCCESS) {
		return -1;
	}
	return 0;
}

#if 0
int import_ecdsa_pub_key(uint8_t *m_pub_key, size_t len_pub_key)
{
	/* Configure the key attributes */
	psa_key_attributes_t key_attributes = PSA_KEY_ATTRIBUTES_INIT;
	psa_status_t status;

	/* Configure the key attributes */
	psa_set_key_usage_flags(&key_attributes, PSA_KEY_USAGE_VERIFY_HASH);
	psa_set_key_lifetime(&key_attributes, PSA_KEY_LIFETIME_VOLATILE);
	psa_set_key_algorithm(&key_attributes, PSA_ALG_ECDSA(PSA_ALG_SHA_256));
	psa_set_key_type(&key_attributes, PSA_KEY_TYPE_ECC_PUBLIC_KEY(PSA_ECC_FAMILY_SECP_R1));
	psa_set_key_bits(&key_attributes, 256);

	status = psa_import_key(&key_attributes, m_pub_key, sizeof(m_pub_key), &pub_key_handle);
	if (status != PSA_SUCCESS) {
		LOG_INF("psa_import_key failed! (Error: %d)", status);
		return -1;
	}

	/* After the key handle is acquired the attributes are not needed */
	psa_reset_key_attributes(&key_attributes);

	return 0;
}

int sign_message(void)
{
	uint32_t output_len;
	psa_status_t status;

	LOG_INF("Signing a message using ECDSA...");

	/* Compute the SHA256 hash*/
	status = psa_hash_compute(PSA_ALG_SHA_256,
				  m_plain_text,
				  sizeof(m_plain_text),
				  m_hash,
				  sizeof(m_hash),
				  &output_len);
	if (status != PSA_SUCCESS) {
		LOG_INF("psa_hash_compute failed! (Error: %d)", status);
		return -1;
	}

	/* Sign the hash */
	status = psa_sign_hash(keypair_handle,
			       PSA_ALG_ECDSA(PSA_ALG_SHA_256),
			       m_hash,
			       sizeof(m_hash),
			       m_signature,
			       sizeof(m_signature),
			       &output_len);
	if (status != PSA_SUCCESS) {
		LOG_INF("psa_sign_hash failed! (Error: %d)", status);
		return -1;
	}

	LOG_INF("Signing the message successful!");
	PRINT_HEX("Plaintext", m_plain_text, sizeof(m_plain_text));
	PRINT_HEX("SHA256 hash", m_hash, sizeof(m_hash));
	PRINT_HEX("Signature", m_signature, sizeof(m_signature));

	return 0;
}
#endif

static void base64_url_format(char *const base64_string)
{
	if (base64_string == NULL) {
		return;
	}

	char *found = NULL;

	/* replace '+' with "-" */
	for (found = base64_string; (found = strchr(found, '+'));) {
		*found = '-';
	}

	/* replace '/' with "_" */
	for (found = base64_string; (found = strchr(found, '/'));) {
		*found = '_';
	}

	/* remove padding '=' */
	found = strchr(base64_string, '=');
	if (found) {
		*found = '\0';
	}
}

int app_jwt_generate(uint32_t time_valid_s, char *const jwt_buf, size_t jwt_buf_sz)
{
	if (!jwt_buf || !jwt_buf_sz) {
		return -EINVAL;
	}

	#define GET_TIME_CMD "AT%%CCLK?"
	int err;
	char buf[NRF_CLOUD_CLIENT_ID_MAX_LEN + 1];
	struct jwt_data jwt = {
		.audience = NULL,
		.sec_tag = CONFIG_COAP_SECTAG,
		.key = JWT_KEY_TYPE_CLIENT_PRIV,
		.alg = JWT_ALG_TYPE_ES256,
		.jwt_buf = jwt_buf,
		.jwt_sz = jwt_buf_sz
	};

	/* Check if modem time is valid */
	err = nrf_modem_at_cmd(buf, sizeof(buf), GET_TIME_CMD);
	if (err != 0) {
		LOG_ERR("Modem does not have valid date/time, JWT not generated");
		return -ETIME;
	}

	if (time_valid_s > NRF_CLOUD_JWT_VALID_TIME_S_MAX) {
		jwt.exp_delta_s = NRF_CLOUD_JWT_VALID_TIME_S_MAX;
	} else if (time_valid_s == 0) {
		jwt.exp_delta_s = NRF_CLOUD_JWT_VALID_TIME_S_DEF;
	} else {
		jwt.exp_delta_s = time_valid_s;
	}

	if (IS_ENABLED(CONFIG_NRF_CLOUD_CLIENT_ID_SRC_INTERNAL_UUID)) {
		/* The UUID is present in the iss claim, so there is no need
		 * to also include it in the sub claim.
		 */
		jwt.subject = NULL;
	} else {
		err = nrf_cloud_client_id_get(buf, sizeof(buf));
		if (err) {
			LOG_ERR("Failed to obtain client id, error: %d", err);
			return err;
		}
		jwt.subject = buf;
	}

	cJSON *header_obj = cJSON_CreateObject();

	if ((cJSON_AddStringToObjectCS(header_obj, "alg", "ES256") == NULL) ||
	    (cJSON_AddStringToObjectCS(header_obj, "typ", "JWT") == NULL)) {
		err = -ENOMEM;
		LOG_ERR("Unable to render json: %d", err);
		cJSON_Delete(header_obj);
		return err;
	}
	char *header = cJSON_PrintUnformatted(header_obj);
	
	if (header == NULL) {
		err = -ENOMEM;
		LOG_ERR("Unable to render json: %d", err);
		cJSON_Delete(header_obj);
		return err;
	}

	cJSON_Delete(header_obj);

	int64_t now;
	cJSON *payload_obj = cJSON_CreateObject();

	date_time_now(&now);
	now /= 1000;

	if (jwt.subject) {
		if (cJSON_AddStringToObjectCS(payload_obj, "sub", jwt.subject) == NULL) {
			err = -ENOMEM;
			LOG_ERR("Unable to render json: %d", err);
			cJSON_Delete(payload_obj);
			return err;
		}
	}
	if ((cJSON_AddNumberToObjectCS(payload_obj, "iat", now) == NULL) ||
	    (cJSON_AddNumberToObjectCS(payload_obj, "exp", now + jwt.exp_delta_s) == NULL)) {
		err = -ENOMEM;
		LOG_ERR("Unable to render json: %d", err);
		cJSON_Delete(payload_obj);
		return err;
	}
	/* iss field contains "nRF9160.<device uuid>" */

	char *payload = cJSON_PrintUnformatted(payload_obj);

	if (payload == NULL) {
		err = -ENOMEM;
		LOG_ERR("Unable to render json: %d", err);
		cJSON_Delete(payload_obj);
		return err;
	}

	cJSON_Delete(payload_obj);

	size_t hlen;
	size_t plen;

	base64_encode(NULL, 0, &hlen, header, strlen(header));
	base64_encode(NULL, 0, &plen, payload, strlen(payload));

	char *msg = k_malloc(hlen + 1 + plen + 1);

	base64_encode(msg, hlen, &hlen, header, strlen(header));
	msg[hlen] = '.';
	base64_encode(&msg[hlen + 1], plen, &plen, payload, strlen(payload));
	msg[hlen + 1 + plen] = '\0';

	base64_url_format(msg);

/*
JWT: eyJ0eXAiOiJKV1QiLCJhbGciOiJFUzI1NiIsImtpZCI6IjA3MDM3NWJkMjQxMTNlOGI4MzM4ZWRiZjUxZDg1NDliMjhjYTBlZjIwMmIxNjA0NGVlOGZjY2EyMjE1NDBiZDYifSAg.eyJpc3MiOiJuUkY5MTYwLjUwNGU1MzUzLTM4MzEtNDVjOC04MDBhLTI3MTlkOGJhMzlmNSIsImp0aSI6Im5SRjkxNjAuZjZlM2JkN2ItN2RmMy00Yjg4LWI0M2EtYTdhOTc2NmEwNGFkLjJmNzM1M2UwYTdkMzMzNWE0N2NmYjFhZDdlM2U5YWNiIiwiaWF0IjoxNjc2OTMwMzU4LCJleHAiOjE2NzY5MzA2NTgsInN1YiI6Im5yZi0zNTI2NTYxMDYxMDgxNDgifSAg.uv7rse7I4-peOgYU2twZc9HpItQU4K3JBYc7vEXPK7S7oLTvfDBoP_63T1J5EIquXLmCTmSTXLPEVcMkJm24FQ
 
header: {
  "typ": "JWT",
  "alg": "ES256",
  "kid": "070375bd24113e8b8338edbf51d8549b28ca0ef202b16044ee8fcca221540bd6"
}

payload: {
  "iss": "nRF9160.504e5353-3831-45c8-800a-2719d8ba39f5",
  "jti": "nRF9160.f6e3bd7b-7df3-4b88-b43a-a7a9766a04ad.2f7353e0a7d3335a47cfb1ad7e3e9acb",
  "iat": 1676930358,
  "exp": 1676930658,
  "sub": "nrf-352656106108148"
}

verify signature:
ECDSASHA256(
  base64UrlEncode(header) + "." +
  base64UrlEncode(payload),
  Public Key in SPKI, PKCS #1, X.509 Certificate, or JWK string format.
  ,
  Private Key in PKCS #8, PKCS #1, or JWK string format. The key never leaves your browser.
)

NOTE:
- omit iss if using sub
- exp = expiration time after which should not be used
- iat = issued at -- time it was issued
- jti = jwt id; must be unique to prevent replay
- kid = key id to perform key lookup
*/

	if (err) {
		LOG_ERR("Failed to generate JWT, error: %d", err);
	}

	return err;
}
```

## src/cbor_encode.h
```c
/*
 * Generated using zcbor version 0.6.0
 * https://github.com/NordicSemiconductor/zcbor
 * Generated with a --default-max-qty of 3
 */

#ifndef CBOR_ENCODE_H__
#define CBOR_ENCODE_H__

#include <stdint.h>
#include <stdbool.h>
#include <stddef.h>
#include <string.h>
#include "zcbor_encode.h"
#include "cbor_encode_types.h"

#if DEFAULT_MAX_QTY != 3
#error "The type file was generated with a different default_max_qty than this file"
#endif


int cbor_encode_location_req(
		uint8_t *payload, size_t payload_len,
		const struct location_req *input,
		size_t *payload_len_out);


#endif /* CBOR_ENCODE_H__ */
```

## src/cbor_encode_types.h
```c
/*
 * Generated using zcbor version 0.6.0
 * https://github.com/NordicSemiconductor/zcbor
 * Generated with a --default-max-qty of 3
 */

#ifndef CBOR_ENCODE_TYPES_H__
#define CBOR_ENCODE_TYPES_H__

#include <stdint.h>
#include <stdbool.h>
#include <stddef.h>
#include <string.h>
#include "zcbor_encode.h"

/** Which value for --default-max-qty this file was created with.
 *
 *  The define is used in the other generated file to do a build-time
 *  compatibility check.
 *
 *  See `zcbor --help` for more information about --default-max-qty
 */
#define DEFAULT_MAX_QTY 3

struct ncell {
	uint32_t _ncell_earfcn;
	uint32_t _ncell_pci;
	int32_t _ncell_rsrp;
	uint_fast32_t _ncell_rsrp_present;
	double _ncell_rsrq;
	uint_fast32_t _ncell_rsrq_present;
	int32_t _ncell_timeDiff;
	uint_fast32_t _ncell_timeDiff_present;
};

struct cell {
	int32_t _cell_mcc;
	int32_t _cell_mnc;
	uint32_t _cell_eci;
	uint32_t _cell_tac;
	uint32_t _cell_earfcn;
	uint_fast32_t _cell_earfcn_present;
	uint32_t _cell_adv;
	uint_fast32_t _cell_adv_present;
	struct ncell _cell_nmr_ncells[5];
	uint_fast32_t _cell_nmr_ncells_count;
	int32_t _cell_rsrp;
	uint_fast32_t _cell_rsrp_present;
	double _cell_rsrq;
	uint_fast32_t _cell_rsrq_present;
};

struct lte {
	struct cell _lte__cell[5];
	uint_fast32_t _lte__cell_count;
};

struct ap {
	struct zcbor_string _ap_mac;
	uint32_t _ap_age;
	uint_fast32_t _ap_age_present;
	uint32_t _ap_freq;
	uint_fast32_t _ap_freq_present;
	int32_t _ap_rssi;
	uint_fast32_t _ap_rssi_present;
	uint32_t _ap_ch;
	uint_fast32_t _ap_ch_present;
	struct zcbor_string _ap_ssid;
	uint_fast32_t _ap_ssid_present;
};

struct wifi {
	struct ap _wifi__ap[20];
	uint_fast32_t _wifi__ap_count;
};

struct location_req {
	struct lte _location_req__lte;
	uint_fast32_t _location_req__lte_present;
	struct wifi _location_req__wifi;
	uint_fast32_t _location_req__wifi_present;
};


#endif /* CBOR_ENCODE_TYPES_H__ */
```

## src/cbor_xcode.c
```c
/*
 * Generated using zcbor version 0.6.0
 * https://github.com/NordicSemiconductor/zcbor
 * Generated with a --default-max-qty of 3
 */

#include <stdint.h>
#include <stdbool.h>
#include <stddef.h>
#include <string.h>
#include "zcbor_encode.h"
#include "cbor_xcode.h"

#if DEFAULT_MAX_QTY != 5
#error "The type file was generated with a different default_max_qty than this file"
#endif

static bool encode_ncell(zcbor_state_t *state, const struct ncell *input);

static bool encode_cell(zcbor_state_t *state, const struct cell *input);

static bool encode_lte(zcbor_state_t *state, const struct lte *input);

static bool encode_ap(zcbor_state_t *state, const struct ap *input);

static bool encode_wifi(zcbor_state_t *state, const struct wifi *input);

static bool encode_groundfix(zcbor_state_t *state, const struct groundfix *input);


static bool encode_ncell(
		zcbor_state_t *state, const struct ncell *input)
{
	zcbor_print("%s\r\n", __func__);

	bool tmp_result = (((zcbor_list_start_encode(state, 5) && ((((zcbor_uint32_encode(state, (&(*input)._ncell_earfcn))))
	&& ((zcbor_uint32_encode(state, (&(*input)._ncell_pci))))
	&& zcbor_present_encode(&((*input)._ncell_rsrp_present), (zcbor_encoder_t *)zcbor_int32_encode, state, (&(*input)._ncell_rsrp))
	&& zcbor_present_encode(&((*input)._ncell_rsrq_present), (zcbor_encoder_t *)zcbor_float64_encode, state, (&(*input)._ncell_rsrq))
	&& zcbor_present_encode(&((*input)._ncell_timeDiff_present), (zcbor_encoder_t *)zcbor_int32_encode, state, (&(*input)._ncell_timeDiff))) || (zcbor_list_map_end_force_encode(state), false)) && zcbor_list_end_encode(state, 5))));

	if (!tmp_result)
		zcbor_trace();

	return tmp_result;
}


static bool encode_cell(
		zcbor_state_t *state, const struct cell *input)
{
	zcbor_print("%s\r\n", __func__);

	bool tmp_result = (((zcbor_list_start_encode(state, 9) && ((((zcbor_int32_encode(state, (&(*input)._cell_mcc))))
	&& ((zcbor_int32_encode(state, (&(*input)._cell_mnc))))
	&& ((zcbor_uint32_encode(state, (&(*input)._cell_eci))))
	&& ((zcbor_uint32_encode(state, (&(*input)._cell_tac))))
	&& zcbor_present_encode(&((*input)._cell_earfcn_present), (zcbor_encoder_t *)zcbor_uint32_encode, state, (&(*input)._cell_earfcn))
	&& zcbor_present_encode(&((*input)._cell_adv_present), (zcbor_encoder_t *)zcbor_uint32_encode, state, (&(*input)._cell_adv))
	&& ((zcbor_list_start_encode(state, CONFIG_LTE_NEIGHBOR_CELLS_MAX) && ((zcbor_multi_encode_minmax(0, CONFIG_LTE_NEIGHBOR_CELLS_MAX, &(*input)._cell_nmr_ncells_count, (zcbor_encoder_t *)encode_ncell, state, (&(*input)._cell_nmr_ncells), sizeof(struct ncell))) || (zcbor_list_map_end_force_encode(state), false)) && zcbor_list_end_encode(state, CONFIG_LTE_NEIGHBOR_CELLS_MAX)))
	&& zcbor_present_encode(&((*input)._cell_rsrp_present), (zcbor_encoder_t *)zcbor_int32_encode, state, (&(*input)._cell_rsrp))
	&& zcbor_present_encode(&((*input)._cell_rsrq_present), (zcbor_encoder_t *)zcbor_float64_encode, state, (&(*input)._cell_rsrq))) || (zcbor_list_map_end_force_encode(state), false)) && zcbor_list_end_encode(state, 9))));

	if (!tmp_result)
		zcbor_trace();

	return tmp_result;
}


static bool encode_lte(
		zcbor_state_t *state, const struct lte *input)
{
	zcbor_print("%s\r\n", __func__);

	bool tmp_result = (((zcbor_list_start_encode(state, 5) && ((zcbor_multi_encode_minmax(1, 5, &(*input)._lte__cell_count, (zcbor_encoder_t *)encode_cell, state, (&(*input)._lte__cell), sizeof(struct cell))) || (zcbor_list_map_end_force_encode(state), false)) && zcbor_list_end_encode(state, 5))));

	if (!tmp_result)
		zcbor_trace();

	return tmp_result;
}


static bool encode_ap(
		zcbor_state_t *state, const struct ap *input)
{
	zcbor_print("%s\r\n", __func__);

	bool tmp_result = (((zcbor_list_start_encode(state, 6) && ((((zcbor_tstr_encode(state, (&(*input)._ap_mac))))
	&& zcbor_present_encode(&((*input)._ap_age_present), (zcbor_encoder_t *)zcbor_uint32_encode, state, (&(*input)._ap_age))
	&& zcbor_present_encode(&((*input)._ap_freq_present), (zcbor_encoder_t *)zcbor_uint32_encode, state, (&(*input)._ap_freq))
	&& zcbor_present_encode(&((*input)._ap_rssi_present), (zcbor_encoder_t *)zcbor_int32_encode, state, (&(*input)._ap_rssi))
	&& zcbor_present_encode(&((*input)._ap_ch_present), (zcbor_encoder_t *)zcbor_uint32_encode, state, (&(*input)._ap_ch))
	&& zcbor_present_encode(&((*input)._ap_ssid_present), (zcbor_encoder_t *)zcbor_tstr_encode, state, (&(*input)._ap_ssid))) || (zcbor_list_map_end_force_encode(state), false)) && zcbor_list_end_encode(state, 6))));

	if (!tmp_result)
		zcbor_trace();

	return tmp_result;
}


static bool encode_wifi(
		zcbor_state_t *state, const struct wifi *input)
{
	zcbor_print("%s\r\n", __func__);

	bool tmp_result = (((zcbor_list_start_encode(state, 60) && ((zcbor_multi_encode_minmax(2, 60, &(*input)._wifi__ap_count, (zcbor_encoder_t *)encode_ap, state, (&(*input)._wifi__ap), sizeof(struct ap))) || (zcbor_list_map_end_force_encode(state), false)) && zcbor_list_end_encode(state, 60))));

	if (!tmp_result)
		zcbor_trace();

	return tmp_result;
}


static bool encode_groundfix(
		zcbor_state_t *state, const struct groundfix *input)
{
	zcbor_print("%s\r\n", __func__);

	bool tmp_result = (((zcbor_list_start_encode(state, 6) && ((zcbor_multi_encode_minmax(0, 1, &(*input)._groundfix__lte_count, (zcbor_encoder_t *)encode_lte, state, (&(*input)._groundfix__lte), sizeof(struct lte))
	&& zcbor_multi_encode_minmax(0, 1, &(*input)._groundfix__wifi_count, (zcbor_encoder_t *)encode_wifi, state, (&(*input)._groundfix__wifi), sizeof(struct wifi))) || (zcbor_list_map_end_force_encode(state), false)) && zcbor_list_end_encode(state, 6))));

	if (!tmp_result)
		zcbor_trace();

	return tmp_result;
}



int cbor_encode_groundfix(
		uint8_t *payload, size_t payload_len,
		const struct groundfix *input,
		size_t *payload_len_out)
{
	zcbor_state_t states[7];

	zcbor_new_state(states, sizeof(states) / sizeof(zcbor_state_t), payload, payload_len, 1);

	bool ret = encode_groundfix(states, input);

	if (ret && (payload_len_out != NULL)) {
		*payload_len_out = MIN(payload_len,
				(size_t)states[0].payload - (size_t)payload);
	}

	if (!ret) {
		int err = zcbor_pop_error(states);

		zcbor_print("Return error: %d\r\n", err);
		return (err == ZCBOR_SUCCESS) ? ZCBOR_ERR_UNKNOWN : err;
	}
	return ZCBOR_SUCCESS;
}
```

## src/cbor_xcode.h
```c
/*
 * Generated using zcbor version 0.6.0
 * https://github.com/NordicSemiconductor/zcbor
 * Generated with a --default-max-qty of 3
 */

#ifndef CBOR_XCODE_H__
#define CBOR_XCODE_H__

#include <stdint.h>
#include <stdbool.h>
#include <stddef.h>
#include <string.h>
#include "zcbor_encode.h"
#include "cbor_xcode_types.h"

#if DEFAULT_MAX_QTY != 3
#error "The type file was generated with a different default_max_qty than this file"
#endif


int cbor_encode_groundfix(
		uint8_t *payload, size_t payload_len,
		const struct groundfix *input,
		size_t *payload_len_out);


#endif /* CBOR_XCODE_H__ */
```

## src/cbor_xcode_types.h
```c
/*
 * Generated using zcbor version 0.6.0
 * https://github.com/NordicSemiconductor/zcbor
 * Generated with a --default-max-qty of 3
 */

#ifndef CBOR_XCODE_TYPES_H__
#define CBOR_XCODE_TYPES_H__

#include <stdint.h>
#include <stdbool.h>
#include <stddef.h>
#include <string.h>
#include "zcbor_encode.h"

/** Which value for --default-max-qty this file was created with.
 *
 *  The define is used in the other generated file to do a build-time
 *  compatibility check.
 *
 *  See `zcbor --help` for more information about --default-max-qty
 */
#define DEFAULT_MAX_QTY 5

struct ncell {

	uint32_t _ncell_earfcn;

	uint32_t _ncell_pci;

	int32_t _ncell_rsrp;

	uint_fast32_t _ncell_rsrp_present;

	double _ncell_rsrq;

	uint_fast32_t _ncell_rsrq_present;

	int32_t _ncell_timeDiff;

	uint_fast32_t _ncell_timeDiff_present;

};



struct cell {

	int32_t _cell_mcc;

	int32_t _cell_mnc;

	uint32_t _cell_eci;

	uint32_t _cell_tac;

	uint32_t _cell_earfcn;

	uint_fast32_t _cell_earfcn_present;

	uint32_t _cell_adv;

	uint_fast32_t _cell_adv_present;

	struct ncell _cell_nmr_ncells[CONFIG_LTE_NEIGHBOR_CELLS_MAX];

	uint_fast32_t _cell_nmr_ncells_count;

	int32_t _cell_rsrp;

	uint_fast32_t _cell_rsrp_present;

	double _cell_rsrq;

	uint_fast32_t _cell_rsrq_present;

};



struct lte {

	struct cell _lte__cell[5];

	uint_fast32_t _lte__cell_count;

};



struct ap {

	struct zcbor_string _ap_mac;

	uint32_t _ap_age;

	uint_fast32_t _ap_age_present;

	uint32_t _ap_freq;

	uint_fast32_t _ap_freq_present;

	int32_t _ap_rssi;

	uint_fast32_t _ap_rssi_present;

	uint32_t _ap_ch;

	uint_fast32_t _ap_ch_present;

	struct zcbor_string _ap_ssid;

	uint_fast32_t _ap_ssid_present;

};



struct wifi {

	struct ap _wifi__ap[60];

	uint_fast32_t _wifi__ap_count;

};



struct groundfix {

	struct lte _groundfix__lte[1];

	uint_fast32_t _groundfix__lte_count;

	struct wifi _groundfix__wifi[1];

	uint_fast32_t _groundfix__wifi_count;

};


#endif /* CBOR_XCODE_TYPES_H__ */
```
