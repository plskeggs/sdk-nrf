## applications/apricity_gateway/Kconfig
```kconfig
#
# Copyright (c) 2018 Nordic Semiconductor ASA
#
# SPDX-License-Identifier: LicenseRef-BSD-5-Clause-Nordic
#

menu "Apricity Gateway"

config APPLICATION_WORKQUEUE_STACK_SIZE
	int "Application workqueue stack size"
	default 2048

config APPLICATION_WORKQUEUE_PRIORITY
	int "Application workqueue priority"
	default SYSTEM_WORKQUEUE_PRIORITY

choice
	prompt "GPS device"
	default GPS_USE_SIM
	help
		Select from which device GPS data will be fetched.

config GPS_USE_SIM
	bool "Use GPS simulator"
	select GPS_SIM
	select GPS_SIM_TRIGGER
	help
		Use simulated GPS data.

config GPS_USE_EXTERNAL
	bool "User provided GPS device"
	help
		Provide a GPS device that location data will be fetched from and
		sent to nRF Cloud

endchoice

if GPS_USE_SIM

config GPS_DEV_NAME
	string
	default GPS_SIM_DEV_NAME

config GPS_TRIGGER
	bool
	default GPS_SIM_TRIGGER

endif

if GPS_USE_EXTERNAL
config GPS_DEV_NAME
	string "GPS device name"
	help
		GPS device from which location data will be fetched and sent
		to nRF Cloud.

endif

config MQTT_KEEPALIVE
	int
	default 1200

config CLOUD_WAIT_DURATION
	int "Cloud connection acknowledge wait duration"
	default 30
	help
	    How long the device should wait for a CONNACK
	    event from the cloud.

choice
	prompt "nRF Cloud user association"
	default CLOUD_UA_BUTTONS
	help
		Select which method to use for nRF Cloud user association
		input.

config CLOUD_UA_BUTTONS
	bool "Use buttons and switches"
	help
		Use buttons and switches on the development kit to provide
		user association input.

config CLOUD_UA_CONSOLE
	bool "Use console input"
	help
		Use console to enter nRF Cloud user association input.
		Allowed input is as follows:
		'b1' = Button 1
		'b2' = Button 2
		's1' = Switch 1
		's2' = Switch 2

endchoice

config CLOUD_FOTA_APP
	bool "Enable firmware over-the-air upgrades for application"
	depends on AWS_FOTA
	depends on DFU_TARGET_MCUBOOT
	default y

config CLOUD_FOTA_MODEM
	bool "Enable firmware over-the-air upgrades for modem"
	depends on AWS_FOTA
	depends on DFU_TARGET_MODEM
	default y

config DEVICE_ID
	string "Device ID"
	default "REPLACE_ME"
  help
    Device id in certificate
	
config APR_GATEWAY
	bool "Apricity Gateway"
	default y
  help
    Defines if gateway
	

endmenu

menu "Zephyr Kernel"
source "$ZEPHYR_BASE/Kconfig.zephyr"
endmenu
```

## applications/apricity_gateway/sample.yaml
```yaml
sample:
  name: LTE-BLE gateway sample
tests:
  test_build:
    build_only: true
    build_on_all: true
    platform_whitelist: nrf9160_pca20035ns
    tags: ci_build
```

## subsys/net/lib/nrf_cloud/Kconfig.nrf_cloud_coap
```kconfig
# Copyright (c) 2023 Nordic Semiconductor
#
# SPDX-License-Identifier: LicenseRef-Nordic-5-Clause
#

menuconfig NRF_CLOUD_COAP
	bool "nRF Cloud COAP"
	select CJSON_LIB
	select ZCBOR
	select COAP
	select COAP_EXTENDED_OPTIONS_LEN
	select COAP_CLIENT
       select EXPERIMENTAL

if NRF_CLOUD_COAP

config NRF_CLOUD_COAP_SERVER_HOSTNAME
	string "CoAP server hostname"
	default "coap.dev.nrfcloud.com"

menuconfig NRF_CLOUD_COAP_DTLS
	bool "CoAP client with DTLS support"
	help
	  If y, use together with either overlay-mbedtls.conf or
	  overlay-offload-tls.conf.

if NRF_CLOUD_COAP_DTLS

config NRF_CLOUD_COAP_DTLS_CID
	bool "Connection ID support"
	help
	  If y, use CID socket options.

endif

config NRF_CLOUD_COAP_SEC_TAG
	int "Security tag in which to store credentials"
	default 86

config NRF_CLOUD_COAP_THREAD_STACK_SIZE
	int "Stack size for CoAP reception thread"
	default 4096

config NRF_CLOUD_COAP_SERVER_PORT
	int "CoAP server port"
	default 5684 if NRF_CLOUD_COAP_DTLS
	default 5683

config NRF_CLOUD_COAP_RESPONSE_TIMEOUT_MS
	int "Number of ms to wait for a response from the CoAP server"
       default 15000

module = NRF_CLOUD_COAP
module-str = nRF Cloud COAP
source "subsys/logging/Kconfig.template.log_config"

endif # NRF_CLOUD_COAP
```

## subsys/net/lib/nrf_cloud/Kconfig.nrf_cloud_logs
```kconfig
# Copyright (c) 2023 Nordic Semiconductor
#
# SPDX-License-Identifier: LicenseRef-Nordic-5-Clause
#

menuconfig NRF_CLOUD_LOGS
	depends on NRF_CLOUD_MQTT || NRF_CLOUD_REST
	depends on !LOG_MODE_IMMEDIATE
	depends on !LOG_PRINTK
	depends on !LOG_MODE_MINIMAL
	select BASE64 if LOG_BACKEND_NRF_CLOUD_OUTPUT_DICTIONARY
	select RING_BUFFER
	bool "nRF Cloud Logging System"

config NRF_CLOUD_LOGS_LEVEL
	int "Only log entries less than or equal to this will be sent"
	range 0 4
	default 1
	help
	  Set overall log level for nRF Cloud logging. Set to 0 to
	  disable.

config NRF_CLOUD_LOG_BUF_SIZE
	int "Number of bytes to buffer in RAM before flushing"
	default 256
	help
	  Set size in bytes for buffer for log output system before it flushes.

if NRF_CLOUD_LOGS

config NRF_CLOUD_LOGS_SEQ_ALWAYS
	bool "Always include the sequence number in log messages"
	default y
	help
	  If set, send the seq field regardless of whether the ts field
	  is set.  If not set, only send the seq field when ts is not
	  available.

config NRF_CLOUD_LOG_RING_BUF_SIZE
	int "Size of buffer for log output before network transfer"
	default 2048
	help
	  Set size in bytes for buffer for log output system to combine log
	  messages before it uploads to nRF Cloud.

config NRF_CLOUD_LOG_DICT_JSON
	bool "Convert binary dictionary data to JSON and base64"
	default y if LOG_BACKEND_NRF_CLOUD_OUTPUT_DICTIONARY
	depends on BASE64
	help
	  Convert dictionary log output to base64, then wrap it in simple JSON
	  so binary-incapable network transfer can occur, at the price of a
	  slight increase in payload size.

backend = NRF_CLOUD
backend = NRF_CLOUD
backend-str = nrf_cloud
source "subsys/logging/Kconfig.template.log_format_config"

endif # NRF_CLOUD_LOGS

module = NRF_CLOUD_LOGGER
module-str = nRF Cloud Logs
source "subsys/logging/Kconfig.template.log_config"
```

## tests/subsys/net/lib/nrf_cloud/client_id/testcase.yaml
```yaml
common:
  platform_allow: native_posix
  integration_platforms:
    - native_posix
  tags: ci_build nrf_cloud_test nrf_cloud_lib ci_tests_subsys_net
tests:
  net.lib.nrf_cloud.client_id:
    sysbuild: true
    timeout: 60
    extra_args:
      - CONFIG_NRF_CLOUD_FOTA_FULL_MODEM_UPDATE=y
    tags: sysbuild ci_tests_subsys_net
```
